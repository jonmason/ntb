## drivers/media/platform/nexell/mpegts/Kconfig
```kconfig
config VIDEO_NEXELL_MPEGTS
	bool "Enable nexell MPEGTS video device"
	default n
	---help---
	  Say y here to enable Nexell S5Pxx18 series MPEGTS video device.
	  If you want to enable only MPEGTS video dev, don't check this.
```

## drivers/misc/artiktee/Kconfig
```kconfig
#
# To support TEE for ARTIK
#
menu "ARTIK TEE(Trusted Execution Environment)"

config ARTIK_TRUSTZONE_DRIVER
	tristate "ARTIK TrustZone driver"
	depends on ((ARM_TRUSTZONE && (SOC_EXYNOS3250 || SOC_EXYNOS5422)) ||\
				ARCH_S5P6818 || ARCH_S5P4418)
	default y
	help
	  This driver allows you can communicate with ARTIK Secure OS.
	  When you use this driver, the platform has to support Secure OS.

config ARTIK_USE_TZCMA_FOR_CRYPTO
	bool "ARTIK Uses TZCMA for crypto operation on ARTIK"
	depends on (ARTIK_TRUSTZONE_DRIVER && (ARCH_S5P6818 || ARCH_S5P4418 ||\
				SOC_EXYNOS3250))
	default y
	help
	  This driver supports to use continuous memory which is allocated
	  by cma(continuous memory allocator) for crypto operation on artik.

config ARTIK_USE_DMA
	bool "ARTIK Uses DMA for crypto operation on ARTIK"
	depends on (ARTIK_USE_TZCMA_FOR_CRYPTO && (ARCH_S5P6818 ||\
				ARCH_S5P4418))
	default y
	help
	  This driver supports to use dma for crypto operation on artik.
endmenu
```

## drivers/misc/usb_charge/Kconfig
```kconfig
config USB_CHARGE
	bool "Enable USB Charge Driver"
	---help---
	This config enables implementation of USB Charge Driver.

config USB_CHARGE_E522XX
	bool "Support E522XX usb_charge"
	depends on I2C && USB_CHARGE
	default n
	help
```

## drivers/net/wireless/bcmdhd/Kconfig
```kconfig
config BROADCOM_WIFI
	bool "Broadcom WiFi Driver"
	depends on WLAN
	default n
	---help---
	  This is a configuration for Broadcom WLAN driver.

config BCM4330
	tristate "Broadcom 4330 wireless cards support"
	depends on BROADCOM_WIFI
	---help---
	  This module adds support for wireless adapters based on
	  Broadcom 4330 chipset.

config BCM4343
	tristate "Broadcom 4343 wireless cards support"
	depends on BROADCOM_WIFI
	---help---
	  This module adds support for wireless adapters based on
	  Broadcom 4343 chipset.

config BCM4334
	tristate "Broadcom 4334 wireless cards support"
	depends on BROADCOM_WIFI
	---help---
	  This module adds support for wireless adapters based on
	  Broadcom 4334 chipset.

config BCM4335
	tristate "Broadcom 4335 wireless cards support"
	depends on BROADCOM_WIFI
	---help---
	  This module adds support for wireless adapters based on
	  Broadcom 4335 chipset.

config BCM4339
	tristate "Broadcom 4339 wireless cards support"
	depends on BROADCOM_WIFI
	---help---
	  This module adds support for wireless adapters based on
	  Broadcom 4339 chipset.

config BCM4354
	tristate "Broadcom 4354 wireless cards support"
	depends on BROADCOM_WIFI
	---help---
	  This module adds support for wireless adapters based on
	  Broadcom 4354 chipset.

config BCM4358
	tristate "Broadcom 4358 wireless cards support"
	depends on BROADCOM_WIFI
	---help---
	  This module adds support for wireless adapters based on
	  Broadcom 4358 chipset.

config BCM4359
	tristate "Broadcom 4359 wireless cards support"
	depends on BROADCOM_WIFI
	---help---
	  This module adds support for wireless adapters based on
	  Broadcom 4359 chipset.

config BCM43241
	tristate "Broadcom 43241 wireless cards support"
	depends on BROADCOM_WIFI
	---help---
	  This module adds support for wireless adapters based on
	  Broadcom 43241 chipset.

config BCM4334W
	tristate "Broadcom 4334W wireless cards support"
	depends on BROADCOM_WIFI
	---help---
	  This module adds support for wireless adapters based on
	  Broadcom 4334W chipset.

config BCM43455
        tristate "Broadcom 43455 wireless cards support"
        depends on BROADCOM_WIFI
        ---help---
          This module adds support for wireless adapters based on
          Broadcom 43455 chipset.

config BCMDHD_FW_PATH
	depends on BROADCOM_WIFI
	string "Firmware path"
	default "/system/etc/firmware/fw_bcmdhd.bin"
	---help---
	  Path to the firmware file.

config BCMDHD_NVRAM_PATH
	depends on BROADCOM_WIFI
	string "NVRAM path"
	default "/system/etc/wifi/bcmdhd.cal"
	---help---
	  Path to the calibration file.

config BROADCOM_WIFI_RESERVED_MEM
	bool "BROADCOM Reserved memory for wifi device"
	depends on BROADCOM_WIFI
	---help---
	  This is a configuration for Broadcom WLAN driver.

config WIFI_BROADCOM_COB
        bool "BROADCOM WIFI COB"
        depends on (BCM43455 || BCM4343)
        ---help---
          This is a configuration for Broadcom WIFI COB Type.

config BCM4335BT
	bool "BROADCOM BTLOCK Enable"
	depends on BCM4335
	default y
	---help---
	  This is a configuration for bt lock enable.

config WLAN_REGION_CODE
	int "---Region codes for Broadcom WiFi Driver"
	depends on BROADCOM_WIFI
	default 100
	---help---
		This is a region code for Broadcom Wi-Fi featured functions.
		- 100 : EUR OPEN
		- 101 : EUR ORG
		- 200 : KOR OPEN
		- 201 : KOR SKT
		- 202 : KOR KTT
		- 203 : KOR LGT
		- 300 : CHN OPEN

config WLAIBSS
	bool "Advanced IBSS mode"
	depends on (BCM4335 || BCM4339 || BCM4354 || BCM4358 || BCM4359)
	default y
	---help---
	  This is a configuration for Oxygen Network.

config WL_RELMCAST
	bool "Reliable Multicast Support"
	depends on (BCM4335 || BCM4339 || BCM4354 || BCM4358 || BCM4359)
	default y
	---help---
	  This is a configuration for RMC.

config WL_NAN
	bool "NAN Feature"
	depends on BROADCOM_WIFI
	default n
	---help---
	  This is a configuration for NAN Feature.

config BCMDHD_PCIE
	bool "Enable PCIe I/F Support"
	depends on (BCM4354 || BCM4358 || BCM4359)
	---help---
	  Enable PCI Express I/F Support

config BCMDHD_PREALLOC_PKTIDMAP
	bool "BROADCOM PCIE specific memory reserved for PKTIDMAP"
	depends on BROADCOM_WIFI_RESERVED_MEM && BCMDHD_PCIE
	---help---
	  Preallocated memory support for PCIE interface in Broadcom
	  WLAN driver.

config BCMDHD_PREALLOC_MEMDUMP
	bool "BROADCOM PCIE specific memory reserved for MEMDUMP"
	depends on BROADCOM_WIFI_RESERVED_MEM
	---help---
	  Preallocated memory support for dongle memory dump
```

## drivers/net/wireless/sd8977/Kconfig
```kconfig
menuconfig MARVELL_DRIVERS
	bool "Marvell Wireless LAN module drivers"
	depends on NET
	select WIRELESS_EXT
	select WEXT_CORE
	select WEXT_PRIV
	select WEXT_PROC
	---help---
	Marvell kernel module drivers

if MARVELL_DRIVERS

choice
	bool "Choose the chip for marvell wireless"
	default MRVL_WL_SD8977

config MRVL_WL_SD8977
	bool "SD8977"
	---help---
	Marvell NIC driver: SD8977 chipset
	
config MRVL_WL_SD8997
	bool "SD8997"
	---help---
	Marvell combo driver support: SD8997 chipset

endchoice

config MRVL_WLAN_DRIVER
	depends on MRVL_WL_SD8977 || MRVL_WL_SD8997
	tristate "WLAN Driver"
	---help---
	Choose the build type of WLAN driver

config MRVL_BT_DRIVER
	depends on MRVL_WL_SD8977 || MRVL_WL_SD8997
	tristate "BT Driver"
	---help---
	Choose the build type of BT driver

config MRVL_SDIO_OOB_IRQ
	depends on MRVL_WL_SD8977 || MRVL_WL_SD8997
	tristate "Enable SDIO OOB IRQ"
	---help---
	Choose SDIO interrupt type of SD8977 driver

endif
```

## drivers/pinctrl/nexell/Kconfig
```kconfig
#
# NEXELL Pin control drivers
#
config PINCTRL_NEXELL
	bool "Nexell SoC pinctrl driver"
	select PINMUX
	select PINCONF

config PINCTRL_S5PXX18
	def_bool y if (ARCH_S5P4418 || ARCH_S5P6818)
	select PINCTRL_NEXELL

config PINCTRL_NXP5540
	def_bool y if ARCH_NXP5540
	select PINCTRL_NEXELL
```

## drivers/soc/Kconfig
```kconfig
menu "SOC (System On Chip) specific Drivers"

source "drivers/soc/brcmstb/Kconfig"
source "drivers/soc/mediatek/Kconfig"
source "drivers/soc/qcom/Kconfig"
source "drivers/soc/rockchip/Kconfig"
source "drivers/soc/sunxi/Kconfig"
source "drivers/soc/ti/Kconfig"
source "drivers/soc/versatile/Kconfig"
source "drivers/soc/nexell/Kconfig"

if ARCH_S5P6818
source "drivers/soc/nexell/Kconfig"
endif
endmenu
```

## drivers/soc/friendlyelec/Kconfig
```kconfig
#
# Machine drivers
#

if ARCH_S5P6818

config MACH_NANOPI3
	bool "FriendlyElec NanoPi 3 Series Machine"
	default y

endif

if ARCH_S5P4418

config MACH_NANOPI2
	bool "FriendlyElec NanoPi 2 Series Machine"
	default y

endif
```

## drivers/soc/nexell/s5p6818/Kconfig
```kconfig
menu "NEXELL s5p6818"

config SOC_S5P6818_GPIO
	bool "SoC s5p6818 GPIO-ALIVE device driver"
	depends on ARCH_S5P6818
	help
	  This enables support for the SoC gpio/alive on the Nexell s5p6818.
	  This driver is responsible all of controlling gpio/alive functions.

endmenu
```

## drivers/staging/samsung/Kconfig
```kconfig
menu "SAMSUNG"

config SAMSUNG
	bool "Samsung Drivers"
	default N
	help
	  Enable support for samsung specific drivers

if SAMSUNG

config SEC_SYSFS
	bool "Samsung sysfs class device"
	default N
	help
	  This option provide sysfs node which name is 'sec' for representing
	  samsung devices through sysfs node.
endif

endmenu
```

## sound/soc/nexell/Kconfig
```kconfig
#
# Copyright 2016 Nexell.
#
# Configuration options for the Nexell Sound

config SND_NX_SOC
	tristate "Nexell SoC Audio"
	depends on ARCH_S5P4418 || ARCH_S5P6818 || ARCH_NXP5540
	select AMBA_PL08X
	help
	  Say Y or M if you want to add support for codecs attached to
	  the AC97 and I2S interface.

config SND_NX_I2S
	tristate

config SND_NX_I2S_CH0
	bool "I2S 0"
	depends on SND_NX_SOC
	select SND_NX_I2S
	default y

config SND_NX_I2S_CH1
	bool "I2S 1"
	depends on SND_NX_SOC
	select SND_NX_I2S
	default n

config SND_NX_I2S_CH2
	bool "I2S 2"
	depends on SND_NX_SOC
	select SND_NX_I2S
	default n

config SND_NX_SPDIF_TX
	tristate

config SND_SPDIF_TRANSCEIVER
	tristate "SPDIF transceiver (PCM)"
	depends on SND_NX_SOC
	select SND_NX_SPDIF_TX
	select SND_SOC_SPDIF

config SND_NX_SPI
	tristate "SPI receiver (PCM)"
	depends on SND_NX_SOC

choice
	prompt "SPI device"
	depends on SND_NX_SPI

	config SND_NX_SPI_PL022
		bool "ARM AMBA PL022 SSP controller"
		help
	  	  This selects the ARM(R) AMBA(R) PrimeCell PL022 SSP
	  	  controller. If you have an embedded system with an AMBA(R)
	  	  bus and a PL022 controller, say Y here.

endchoice

config SND_NX_FEEDBACK
	tristate "Nexell feedback sound device"
	depends on SND_NX_SOC
	help
	  This option enables nexell feedback sound device support

config SND_CODEC_NULL
	tristate "I2S audio null codec."
	depends on SND_NX_I2S

config SND_CODEC_ES8316
	tristate "es8316 I2S audio codec."
	depends on SND_NX_I2S
	select SND_SOC_ES8316

config SND_CODEC_ALC5658
	tristate "ALC5658 I2S audio codec."
	depends on SND_NX_I2S
	select SND_SOC_RT5659

config SND_CODEC_RT5640
	tristate "RT5640 I2S audio codec."
	depends on SND_NX_I2S
	select SND_SOC_RT5640

config SND_CODEC_ALC5623
	tristate "ALC5623 I2S audio codec."
	depends on SND_NX_I2S
	select SND_SOC_ALC5623

config SND_CODEC_SMARTVOICE
	tristate "Smart Voice spi/i2s audio codec."
	depends on SND_NX_SPI

config SND_NX_SIMPLE_CARD
	tristate "Nexell Simple sound card support"
	help
	  This option enables nexell simple sound card support
```
