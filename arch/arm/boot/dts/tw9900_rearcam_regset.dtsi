/*
 * Copyright (C) 2016  Nexell Co., Ltd.
 * Author: Jongkeun, Choi <jkchoi@nexell.co.kr>
 *
 * This program is free software; you can redistribute it and/or
 * modify it under the terms of the GNU General Public License
 * as published by the Free Software Foundation; either version 2
 * of the License, or (at your option) any later version.
 *
 * This program is distributed in the hope that it will be useful,
 * but WITHOUT ANY WARRANTY; without even the implied warranty of
 * MERCHANTABILITY or FITNESS FOR A PARTICULAR PURPOSE.  See the
 * GNU General Public License for more details.
 *
 * You should have received a copy of the GNU General Public License
 * along with this program.  If not, see <http://www.gnu.org/licenses/>.
 */

/ {
	sensor_tw9900:register {
		data =  <0x02 0x40>,
			<0x03 0xa2>,
			<0x07 0x02>,
			<0x08 0x12>,
			<0x09 0xf0>,
			<0x0a 0x1c>,
			<0x0b 0xc0>,
			<0x1b 0x00>,
			<0x10 0xec>,
			<0x11 0x64>,
			<0x2f 0xe6>,
			<0x55 0x00>,
			<0xaf 0x00>,
			<0xb1 0x20>,
			<0xb4 0x20>;
	};
};
