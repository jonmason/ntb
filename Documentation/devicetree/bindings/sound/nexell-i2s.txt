## Documentation/devicetree/bindings/sound/nexell-i2s.txt
```
Nexell I2S controller

Required Properties:

- compatible : should be one of the following.
   - nexell,nexell-i2s: for 8/16/24bit stereo I2S.
- reg: physical base address of the controller and length of memory mapped
  region.
- dmas: list of DMA controller phandle and DMA request line ordered pairs.
- dma-names: identifier string for each DMA request line in the dmas property.
  These strings correspond 1:1 with the ordered pairs in dmas.
- clocks: Handle to iis clock.
- clock-names:
  i2s0 uses some base clks from CMU and some are from audio subsystem internal
  clock controller. The clock names for i2s0 should be "i2s0", "i2s1" and
  "i2s2" as shown in the example below.
- resets : phandle to the parent reset controller.
  - "nexell_reset" - reset-controller,
  - "RESET_ID_I2S0" - Nth Reset control id (N = 0, 1, ...)
- reset-names : input names of resets used by the controller

Optional Properties:
- pinctrl-0: Should specify pin control groups used for this controller.
- pinctrl-names: Should contain only one value - "default".
- master-mode : Select master/slave mode
  - 0(slave mode), 1(i2s master mode).
- mclk-in : Select mclk source internal/external.
  - 0(internal), 1(external).
- trans-mode : Select serial data format
  - 0(i2s mode), 1(MSB-justified) or 2(LSB-justified).
- frame-bit : Select frame bit. (16/24/32/48 fs)
- sample-rate : Select sample rate. (8000~192000hz)
- pre-supply-mclk : Select pre supply mclk support.
  - 0(control when i2s start/stop), 1(always on)
- LR-pol-inv : Select L/R polarity intvert option.

Example:

i2s0: i2s0@c0055000 {
	compatible = "nexell,nexell-i2s";
	reg = <PHYS_BASE_I2S0 0x1000>;
	dmas = <&pl08xdma0 12>, <&pl08xdma0 13>;
	dma-names = "tx", "rx";
	clocks = <&i2s0>;;
	clock-names = "i2s0";
	resets = <&nexell_reset RESET_ID_I2S0>;
	reset-names = "i2s-reset";
	pinctrl-names = "default";
	pinctrl-0 = <&i2s0_bus>;
	master_mode = <1>;
	mclk_in = <0>;
	trans_mode = <0>;
	frame_bit = <32>;
	sample_rate = <48000>;
	pre_supply_mclk = <1>;
	LR-pol-inv = <0>;
	status = "okay";
};
```

## Documentation/devicetree/bindings/sound/wm8988.txt
```
WM8988 audio CODEC

This device supports I2C only.

Required properties:

  - compatible : "wlf,wm8988"

  - reg : the I2C address of the device.


Optional properties:


Example:

codec: wm8988@1a {
	compatible = "wlf,wm8988";
	reg = <0x1a>;
};
```

## Documentation/devicetree/bindings/spi/spi-nexell.txt
```
* Nexell SPI Controller

The Samsung SPI controller is used to interface with various devices such as flash
and display controllers using the SPI communication interface.

The Nexell's SPI controller is used same to Samsung SPI contoller.

Required SoC Specific Properties:

- compatible: should be one of the following.
    - nexell,s5p6818-spi - s5p6818 SoC,

- reg: physical base address of the controller and length of memory mapped
  region.

- interrupts: The interrupt number to the cpu. The interrupt specifier format
  depends on the interrupt controller.

- dmas : Two or more DMA channel specifiers following the convention outlined
  in bindings/dma/dma.txt

- dma-names: Names for the dma channels. There must be at least one channel
  named "tx" for transmit and named "rx" for receive.

- resets : phandle to the parent reset controller. SPI has 2 channel reset controls.
 - "nxp_reset" - reset-cotroller,
  - "RESET_ID_SPI<N>_P" - Nth Pre reset control id (N = 0, 1, ...)
  - "RESET_ID_SPI<N>" - Nth Reset control id (N = 0, 1, ...)
- reset-names : input names of resets used by the controller.
	There must has 2 channel named  "pre-reset", "spi-reset".

Required Board Specific Properties:

- #address-cells: should be 1.
- #size-cells: should be 0.

Optional Board Specific Properties:

- samsung,spi-src-clk: If the spi controller includes a internal clock mux to
  select the clock source for the spi bus clock, this property can be used to
  indicate the clock to be used for driving the spi bus clock. If not specified,
  the clock number 0 is used as default.

- num-cs: Specifies the number of chip select lines supported. If
  not specified, the default number of chip select lines is set to 1.

- cs-gpios: should specify GPIOs used for chipselects (see spi-bus.txt)

SPI Controller specific data in SPI slave nodes:

- The spi slave nodes should provide the following information which is required
  by the spi controller.

  - samsung,spi-feedback-delay: The sampling phase shift to be applied on the
    miso line (to account for any lag in the miso line). The following are the
    valid values.

      - 0: No phase shift.
      - 1: 90 degree phase shift sampling.
      - 2: 180 degree phase shift sampling.
      - 3: 270 degree phase shift sampling.

Aliases:

- All the SPI controller nodes should be represented in the aliases node using
  the following format 'spi{n}' where n is a unique number for the alias.


Example:

- SoC Specific Portion:
	spi_0:spi@c005b000 {
		compatible = "nexell,s5p6818-spi";
		reg = <PHYS_BASE_SSP0 0x100>;
		interrupts = <0 IRQ_SSP0 0>;
		dmas = <&pl08xdma0 6>, <&pl08xdma0 7>;
		dma-names = "tx", "rx";
		resets = <&nexell_reset RESET_ID_SSP0_P>,
		       <&nexell_reset RESET_ID_SSP0>;
		reset-names = "pre-reset","spi-reset";
		#address-cells = <1>;
		#size-cells = <0>;
		samsung,spi-src-clk = <0>;
		num-cs = <1>;
		clocks = <&spi0>, <&spi0>;
		clock-names = "spi", "spi_busclk0";
		pinctrl-names = "default";
		pinctrl-0 = <&spi0_bus>;
		status ="disable";
	};

- Board Specific Portion:

	spi_0:spi@c005b000 {
		#address-cells = <1>;
		#size-cells = <0>;
		cs-gpios = <&gpio_c 30 0>;
		status = "okay";

		spidev0@0 {
			compatible ="rohm,dh2228fv";
			reg = <0>;
			spi-max-frequency = <50000000>;
			controller-data {
				smasung,spi-feedback-delay = <02>;
			};
		};
	};
```

## Documentation/devicetree/bindings/thermal/nexell-thermal.txt
```
* Nexell Thermal Management Unit (TMU)

Nexell s5p6818 TMU is used same Samsung TMU.

** Required properties:

- compatible :Must be  "nexell,s5p6818-tmu"

- interrupt-parent : The phandle for the interrupt controller
- reg : Address range of the thermal registers. For soc's which has multiple
	instances of TMU and some registers are shared across all TMU's like
	interrupt related then 2 set of register has to supplied. First set
	belongs	to register set of TMU instance and second set belongs to
	registers shared with the TMU instance.


- interrupts : Should contain interrupt for thermal system
- clocks : The main clocks for TMU device
	-- only use pclk clcok.
- clock-names : Thermal system clock name
	-- "tmu_apbif" operational clock for current TMU channel
- vtmu-supply: This entry is optional and provides the regulator node supplying
		voltage to TMU. If needed this entry can be placed inside
		board/platform specific dts file.
Following properties are mandatory (depending on SoC):
- samsung,tmu_gain: Gain value for internal TMU operation.
- samsung,tmu_reference_voltage: Value of TMU IP block's reference voltage
- samsung,tmu_noise_cancel_mode: Mode for noise cancellation
- samsung,tmu_efuse_value: Default level of temperature - it is needed when
			   in factory fusing produced wrong value
- samsung,tmu_min_efuse_value: Minimum temperature fused value
- samsung,tmu_max_efuse_value: Maximum temperature fused value
- samsung,tmu_first_point_trim: First point trimming value
- samsung,tmu_second_point_trim: Second point trimming value
- samsung,tmu_default_temp_offset: Default temperature offset
- samsung,tmu_cal_type: Callibration type


Example:

	tmuctrl_0: tmuctrl@c0096000 {
		compatible = "nexell,s5p6818-tmu";
		reg = <PHYS_BASE_TMU0 0x100>;
		interrupts = <0 IRQ_TMU0 0>;
		clocks = <&pclk>;
		clock-names = "tmu_apbif";
		#nclude "s5p6818-tmu-sensor-conf.dtsi"
		soc,tieoff = <NX_TIEOFF_Inst_TMU0_SENSING_START 1>;
	};


Note: For multi-instance tmu each instance should have an alias correctly
numbered in "aliases" node.

Example:

aliases {
	tmuctrl0 = &tmuctrl_0;
	tmuctrl1 = &tmuctrl_1;
	tmuctrl2 = &tmuctrl_2;
};
```

## Documentation/devicetree/bindings/tieoff/nexell_tieoff.txt
```
* Nexell tieoff.

Tieoff block is a set of registers that includes special registers which
 don’t need to be set in normal mode operation.
Tieoff block includes special function registers for ARM, HDMI, DRAM controller,
 UART, USB2.0 HOST controller/ Phy, USB2.0 OTG controller/ Phy,
 Ethernet controller, AXI buses and the internal SRAM timing margin controls.

Add the following properties for each device node using the tieoff.

Required properties:

- compatible: should be "nexell,tieoff".
- reg: physical base address of the controller and length of memory mapped
  region.
- soc,tieoff: add to device node of each driver, <tieoff index, tieoff value>
  so on. You can find defines of tieoff index
  at dt-bindings/tieoff/s5p6818-tieoff.h and tieoff value is device specific so
  refer to TRM.

Example:
	tieoff@c0011000 {
		compatible = "nexell,tieoff";
		reg = <PHYS_BASE_TIEOFF 0x1000>;
	};

	serial0:serial@c00a1000 {
		....
		soc,tieoff = <NX_TIEOFF_UART0_USESMC 0>,
			     <NX_TIEOFF_UART0_SMCTXENB 0>,
			     <NX_TIEOFF_UART0_SMCRXENB 0>;
	}
```

## Documentation/devicetree/bindings/timer/nexell-s5p6818-timer.txt
```
Nexell s5p6818 SoCs Timer Controller

Required properties:

- compatible : should be inexell,s5p6818-timer"
- reg : Specifies base physical address and size of the registers.
- interrupts : The interrupt of the first timer
- clocks: phandle to the source clock
- clock-names : must include the following entries:
  clock-names = "timerN"(N= 0,1, n) , "pclk";
- reset-id : reset controller id.

Example:

timer@c0017000 {
	compatible = "nexell,s5p6818-timer";
	reg = <PHYS_BASE_TIMER 0x1000>;
	interrupts = <0 IRQ_TIMER1 0>;
	clksource = <0>;
	clkevent = <1>;
	clocks =  <&timer0>, <&timer1>, <&pclk>;
	clock-names = "timer0", "timer1", "pclk";
};
```

## Documentation/devicetree/bindings/usb/usb2514.txt
```
SMSC USB2514 High-Speed Hub Controller

Required properties:
- compatible: Should be "smsc,usb2514".

Optional properties:
- reg: Specifies the i2c slave address, it is required and should be 0x2c
       if I2C is used.
- reset-gpios: Should specify GPIO for reset.
- initial-mode: Should specify initial mode.
                (1 for HUB mode, 2 for STANDBY mode)

Examples:
	usb2514@2c {
		compatible = "smsc,usb2514";
		reg = <0x2c>;
		reset-gpios = <&gpio_e 7 1>;
		initial-mode = <1>;
	};
```

## Documentation/devicetree/bindings/watchdog/samsung-wdt.txt
```
* Samsung's Watchdog Timer Controller

The Samsung's Watchdog controller is used for resuming system operation
after a preset amount of time during which the WDT reset event has not
occurred.

Required properties:
- compatible : should be one among the following
	(a) "samsung,s3c2410-wdt" for Exynos4 and previous SoCs
	(b) "samsung,exynos5250-wdt" for Exynos5250
	(c) "samsung,exynos5420-wdt" for Exynos5420
	(d) "samsung,exynos7-wdt" for Exynos7
	(e) "nexell,nexell-wdt" for Nexell SoCs

- reg : base physical address of the controller and length of memory mapped
	region.
- interrupts : interrupt number to the cpu.
- samsung,syscon-phandle : reference to syscon node (This property required only
	in case of compatible being "samsung,exynos5250-wdt" or "samsung,exynos5420-wdt".
	In case of Exynos5250 and 5420 this property points to syscon node holding the PMU
	base address)
- clocks : clock provider specifier
- clock-names : shall be "watchdog"
- resets : phandle to the parent reset controller.(only Nexell Soc.)
	- "nexell_reset" - reset-controller,
	- "RESET_ID_WDT", "RESET_ID_WDT_POR" - Nth Reset control id (N = 0, 1, ...)
	- reset-names : input names of resets used by the controller(only Nexell Soc.)

Optional properties:
- timeout-sec : contains the watchdog timeout in seconds.

Example:

watchdog@101D0000 {
	compatible = "samsung,exynos5250-wdt";
	reg = <0x101D0000 0x100>;
	interrupts = <0 42 0>;
	clocks = <&clock 336>;
	clock-names = "watchdog";
	samsung,syscon-phandle = <&pmu_syscon>;
	resets = <&nexell_reset RESET_ID_WDT>,
	       <&nexell_reset RESET_ID_WDT_POR>;
	reset-names = "wdt-reset","wdt-por-reset";
};
```
