## drivers/gud/Kconfig
```kconfig
#
# Trustonic drivers configuration
#
config TRUSTONIC_TEE
    tristate "Trustonic TEE Driver"
    depends on ARM || ARM64
    default n
    ---help---
      Enable Trustonic TEE support

config TRUSTONIC_TEE_LPAE
    bool "Trustonic TEE uses LPAE"
    depends on TRUSTONIC_TEE
    default n
    ---help---
      Enable Trustonic TEE 64-bit physical addresses support

config TRUSTONIC_TEE_DEBUG
    bool "Trustonic TEE driver debug mode"
    depends on TRUSTONIC_TEE
    default n
    ---help---
      Enable the debug mode in the Trustonic TEE Driver.
```

## drivers/input/touchscreen/friendlyelec/Kconfig
```kconfig
#
# Touchscreen driver configuration
#

menuconfig TOUCHSCREEN_FE_PANELS
	bool "Support for FriendlyElec Panels"

if TOUCHSCREEN_FE_PANELS

config TOUCHSCREEN_1WIRE
	tristate "1-Wire host and Touch Screen Driver"
	depends on I2C && PWM
	help
	  Say Y here to enable the 1-Wire host and Touch Screen driver for
	  FriendlyARM NanoPi2 development board.

	  If unsure, say N.

	  To compile this driver as a module, choose M here: the
	  module will be called 1wire_host.

config AUTO_REPORT_1WIRE_INPUT
	tristate "Auto report 1wire data to input system"
	depends on TOUCHSCREEN_1WIRE
	default n
	help
	  Say Y here to enable auto report 1wire touch data to input system.

	  If unsure, say N.

config TOUCHSCREEN_IF
	bool
	default y if TOUCHSCREEN_1WIRE

config TOUCHSCREEN_GT9XX
	tristate "Goodix GT9xx touchscreen driver"
	depends on I2C
	default n
	help
	  Say Y here if you have the Goodix GT9xx touchscreen.

	  If unsure, say N.

config TOUCHSCREEN_IT7260
	tristate "ITE it7260 TouchScreen driver"
	depends on I2C
	help
	  Say Y here to support ITE it7260 based touchscreen on
	  FriendlyARM NanoPi2 development board.

	  If unsure, say N.

	  To compile this driver as a module, choose M here: the
	  module will be called it7260_mts.ko.

config TOUCHSCREEN_HIMAX
	tristate "Himax touchscreen support"
	depends on I2C
	help
	  Say Y here if you have a Himax touchscreen and your
	  board-specific setup code includes that in its table
	  of I2C devices.

	  If unsure, say N.

	  To compile this driver as a module, choose M here: the
	  module will be called himax_ts.

choice
prompt "Select Touch Protocol"
depends on TOUCHSCREEN_FT5X0X || TOUCHSCREEN_GT9XX || TOUCHSCREEN_IT7260 || TOUCHSCREEN_HIMAX
default TOUCHSCREEN_PROT_MT_SLOT

config TOUCHSCREEN_PROT_MT_SYNC
	bool "Multi-touch Protocol A"
	help
	  This enables the stateless type A protocol for QT + tslib.

config TOUCHSCREEN_PROT_MT_SLOT
	bool "Multi-touch Protocol B"
	help
	  This enables the stateful type B slot protocol for Android.

config TOUCHSCREEN_PROT_SINGLE
	bool "Single-touch Protocol"
	help
	  This disables multi-touch mode for Debian (xserver-xorg-input-evdev).

endchoice

endif
```

## drivers/input/touchscreen/melfas_mip4/Kconfig
```kconfig
#
# Kconfig for MELFAS MIP4 Touchscreen Driver
#

if INPUT_TOUCHSCREEN

config TOUCHSCREEN_MELFAS_MIP4
	tristate "MELFAS MIP4 Touchscreen"
	depends on I2C
	help
	  Say Y here if you have a MELFAS MIP4 touchscreen device in your system.
	  If unsure, say N.
	  To compile this driver as a module, choose M here:
	  the module will be called mip4_ts.

config TOUCHSCREEN_MELFAS_MMS427
	tristate "MELFAS MMS427 Touchscreen"
	depends on I2C
	help
	  Say Y here if you have a MELFAS MMS427 touchscreen device in your system.
	  If unsure, say N.
	  To compile this driver as a module, choose M here:
	  the module will be called mip4_ts.

config TOUCHSCREEN_MELFAS_MMS438
	tristate "MELFAS MMS438 Touchscreen"
	depends on I2C
	help
	  Say Y here if you have a MELFAS MMS438 touchscreen device in your system.
	  If unsure, say N.
	  To compile this driver as a module, choose M here: the module will be called mip4_ts.

config TOUCHSCREEN_MELFAS_MMS438S
	tristate "MELFAS MMS438S Touchscreen"
	depends on I2C
	help
	  Say Y here if you have a MELFAS MMS438S touchscreen device in your system.
	  If unsure, say N.
	  To compile this driver as a module, choose M here:
	  the module will be called mip4_ts.

config TOUCHSCREEN_MELFAS_MMS449
	tristate "MELFAS MMS449 Touchscreen"
	depends on I2C
	help
	  Say Y here if you have a MELFAS MMS449 touchscreen device in your system.
	  If unsure, say N.
	  To compile this driver as a module, choose M here:
	  the module will be called mip4_ts.

config TOUCHSCREEN_MELFAS_MMS449S
	tristate "MELFAS MMS449S Touchscreen"
	depends on I2C
	help
	  Say Y here if you have a MELFAS MMS449S touchscreen device in your system.
	  If unsure, say N.
	  To compile this driver as a module, choose M here:
	  the module will be called mip4_ts.

config TOUCHSCREEN_MELFAS_MMS458
	tristate "MELFAS MMS458 Touchscreen"
	depends on I2C
	help
	  Say Y here if you have a MELFAS MMS458 touchscreen device in your system.
	  If unsure, say N.
	  To compile this driver as a module, choose M here:
	  the module will be called mip4_ts.

config TOUCHSCREEN_MELFAS_MMS500
	tristate "MELFAS MMS500 Touchscreen"
	depends on I2C
	help
	  Say Y here if you have a MELFAS MMS500 touchscreen device in your system.
	  If unsure, say N.
	  To compile this driver as a module, choose M here:
	  the module will be called mip4_ts.

config TOUCHSCREEN_MELFAS_MMS587N
	tristate "MELFAS MMS587N Touchscreen"
	depends on I2C
	help
	  Say Y here if you have a MELFAS MMS587N touchscreen device in your system.

	  If unsure, say N.

	  To compile this driver as a module, choose M here: the module will be called mip4_ts.

config TOUCHSCREEN_MELFAS_MMS600
	tristate "MELFAS MMS600 Touchscreen"
	depends on I2C
	help
	  Say Y here if you have a MELFAS MMS600 touchscreen device in your system.
	  If unsure, say N.
	  To compile this driver as a module, choose M here:
	  the module will be called mip4_ts.

config TOUCHSCREEN_MELFAS_MCS6000
	tristate "MELFAS MCS6000 Touchscreen"
	depends on I2C
	help
	  Say Y here if you have a MELFAS MCS6000 touchscreen device in your system.
	  If unsure, say N.
	  To compile this driver as a module, choose M here:
	  the module will be called mip4_ts.

config TOUCHSCREEN_MELFAS_MCS8040L
	tristate "MELFAS MCS8040L Touchscreen"
	depends on I2C
	help
	  Say Y here if you have a MELFAS MCS8040L touchscreen device in your system.
	  If unsure, say N.
	  To compile this driver as a module, choose M here:
	  the module will be called mip4_ts.

config TOUCHSCREEN_MELFAS_MFS10
	tristate "MELFAS MFS10 Touchscreen"
	depends on I2C
	help
	  Say Y here if you have a MELFAS MFS10 touchscreen device in your system.
	  If unsure, say N.
	  To compile this driver as a module, choose M here:
	  the module will be called mip4_ts.

config TOUCHSCREEN_MELFAS_MFS10VE
	tristate "MELFAS MFS10VE Touchscreen"
	depends on I2C
	help
	  Say Y here if you have a MELFAS MFS10VE touchscreen device in your system.
	  If unsure, say N.
	  To compile this driver as a module, choose M here:
	  the module will be called mip4_ts.

config TOUCHSCREEN_MELFAS_MOS50
	tristate "MELFAS MOS50 Touchscreen"
	depends on I2C
	help
	  Say Y here if you have a MELFAS MOS50 touchscreen device in your system.
	  If unsure, say N.
	  To compile this driver as a module, choose M here:
	  the module will be called mip4_ts.

config TOUCHSCREEN_MELFAS_MIT200
	tristate "MELFAS MIT200 Touchscreen"
	depends on I2C
	help
	  Say Y here if you have a MELFAS MIT200 touchscreen device in your system.
	  If unsure, say N.
	  To compile this driver as a module, choose M here:
	  the module will be called mip4_ts.

config TOUCHSCREEN_MELFAS_MIT300
	tristate "MELFAS MIT300 Touchscreen"
	depends on I2C
	help
	  Say Y here if you have a MELFAS MIT300 touchscreen device in your system.
	  If unsure, say N.
	  To compile this driver as a module, choose M here:
	  the module will be called mip4_ts.

config TOUCHSCREEN_MELFAS_MIT400
	tristate "MELFAS MIT400 Touchscreen"
	depends on I2C
	help
	  Say Y here if you have a MELFAS MIT400 touchscreen device in your system.
	  If unsure, say N.
	  To compile this driver as a module, choose M here:
	  the module will be called mip4_ts.

config TOUCHSCREEN_MELFAS_MIT401
	tristate "MELFAS MIT401 Touchscreen"
	depends on I2C
	help
	  Say Y here if you have a MELFAS MIT401 touchscreen device in your system.
	  If unsure, say N.
	  To compile this driver as a module, choose M here:
	  the module will be called mip4_ts.

config TOUCHSCREEN_MELFAS_MIT410
	tristate "MELFAS MIT410 Touchscreen"
	depends on I2C
	help
	  Say Y here if you have a MELFAS MIT410 touchscreen device in your system.
	  If unsure, say N.
	  To compile this driver as a module, choose M here:
	  the module will be called mip4_ts.

endif
```

## drivers/media/platform/nexell/Kconfig
```kconfig
config VIDEO_NEXELL
	bool "Nexell S5Pxx18 SoC series V4l2 Subsystem driver"
	depends on VIDEO_V4L2 && VIDEO_V4L2_SUBDEV_API
	depends on ARCH_S5P6818 || COMPILE_TEST
	depends on OF && COMMON_CLK
	select VIDEOBUF2_DMA_CONTIG
	select RESET_CONTROLLER
	help
	  Say Y here to enable Nexell video devices for S5Pxx18 series SoC.
	  This subsystem includes capture devices. Nexell V4L2 drivers supports
	  only dma_buf type.
```

## drivers/media/platform/nexell/capture/Kconfig
```kconfig
config VIDEO_NEXELL_CLIPPER
	bool "Enable capture clipper video device"
	default n
	---help---
	  Say y here to enable Nexell S5Pxx18 series VIP clipper video device.
	  Clipper video device can crop source crop and has memory interface.
	  If you want to enable only clipper subdev, don't check this.

config VIDEO_NEXELL_DECIMATOR
	bool "Enable capture decimator video device"
	default n
	---help---
	  Say y here to enable Nexell S5Pxx18 series VIP decimator video device.
	  Decimator video device can scale down and has memory interface.

config VIDEO_NEXELL_REARCAM
	bool "Enable fast preview of rear camera device"
	default n
	---help---
	  Say y here, you cna view cmaera as soon as kernel booting, and this
	  driver switch on/off camera by gpio interrupt.

if VIDEO_NEXELL_REARCAM

config VIDEO_NEXELL_REARCAM_SAMPLEPARKINGLINE
	bool "Drawing sample parking assist line with raw data"
	default n
	---help---
	  Say y here to draw a parking assist line using the raw data provided
	  by the sample when drawing the parking assist in the rear camera.

config VIDEO_NEXELL_REARCAM_VENDOR_FMS
	bool "Nexell Rearcam Vendor FMS Driver"
	default n
	---help---
	  Say y here to support a rearcam vendor driver for FMS

endif # VIDEO_NEXELL_REARCAM
```
