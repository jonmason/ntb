## Documentation/devicetree/bindings/bus/nx-busqos.txt
```
Nexell s5p4418 processor bus QoS

properties:
- compatible : Should be "nexell,s5p4418-busqos" for Nexell s5p4418 processor
- reg : Address and length of the register set for the device
- drex_s0_qos_enable, drex_s1_qos_enable :
    It determines whether or not use QoS.
    <0> - does not use QoS settings. The other settings does not apply.
    <1> - using QoS settings
	DREX slave interface port 0 (cpu block) read/write channel QoS
	DREX slave interface port 1 (display/gmac block) read/write channel QoS
- drex_s0_qos_thres, drex_s1_qos_thres :
    <0> ~ <0xf> - BRB reservation threshold
- drex_s0_qos_tout, drex_s1_qos_tout :
    <0> ~ <0xfff> - QoS request timeout for service

For details about this, see SOC datasheet.

busqos {
	compatible = "nexell,s5p4418-busqos";
	reg = <PHYS_BASE_DREX 0x1000>;

	drex_s0_qos_enable = <0>;
	drex_s1_qos_enable = <1>;
	drex_s0_qos_thres = <0x1>;
	drex_s1_qos_thres = <0xf>;
	drex_s0_qos_tout = <0x100>;
	drex_s1_qos_tout = <0x0>;
};
```

## Documentation/devicetree/bindings/clock/nexell-clock.txt
```
* Nxell s5p16818 Clock Controller

The S5p6818 clock controller generates and supplies clock to various
controllers within the s5p6818 SoC.

Required Properties:

- compatible: should be "nexell,s5p6818,clock".

- reg: physical base address of the controller and length of memory mapped
  region.
- #size-xells: should be 1.
- #clock-cells: should be 1.

Optional Properties:
- src-force: select clock source manually.

Example: An example of a clock controller node is listed below.

defines if each clocks in dtsi files.

	clocks {
		compatible = "nexell,s5pxx18,clocks";
		reg = <0xc00bb000 0x30000>;
		#address-cells = <1>;
		#size-cells = <1>;
		ranges;

		pll0: pll0 {
			#clock-cells = <0>;
			clock-names = "sys-pll0";
			clock-output-names = "pll0";
		};

		uart0:uart@c00a9000 {
			#clock-cells = <0>;
			clock-output-names = "uart0";
			cell-id = <CLK_ID_UART_0>;
			reg = <PHYS_BASE_CLK_22 0x1000>;
			clk-step  = <1>;
			clk-input = <CLK_INPUT_UART>;
		};
		...
	};

use clock device driver node.

	serial0:serial@c00a1000 {
		...
		clock-names = "uart", "clk_uart_baud0";
		clocks = <&uart0>, <&uart0>;
};
```

## Documentation/devicetree/bindings/clock/nexell-pll.txt
```
* Nexell s5pxx18 PLL Controller

The S5pxx18 PLL controller within the s5p4418 and s5p6818 SoC.
S5pxx18 support 5 PLLs (PLL0, 1, 2 ,3)


Required Properties:

- compatible: should be "nexell,s5pxx18-pll".
- ref-freuecny: Input oscillator clock Hz.
- reg: physical base address of the controller and length of memory mapped
  region.
Example: An example of a clock controller node is listed below.

	refclk:oscillator {
		compatible = "nexell,s5pxx18,pll";
		ref-freuecny = <24000000>;
	};
```

## Documentation/devicetree/bindings/cpufreq/cpufreq-nexell.txt
```
Nexell cpufreq driver
-------------------

Nexell SoC cpufreq driver for CPU frequency scaling.

Required properties:
- compatible: Should be "nexell,s5pxx18-cpu"

-supply_name: arm vdd control regulator name.
-<arm vdd control regulator name>-supply: arm vdd control node

-max_freq: set max cpu frequency. support 1.6Ghz Overclock.
 default cpu freq
 s5p6818 : 1.4Ghz
 s5p4418 : 1.2Ghz

All the required listed above must be defined under node cpufreq.

Example:
--------
	dynamic-freq@bb000 {
		compatible = "nexell,s5pxx18-cpufreq";
		reg = <0xc00bb000 0x30000>;
		supply_name = "vdd_core_regulator";
		vdd_core_regulator-supply = <&VCC_DCDC0>;
		max_freq = <16000000>;
	};
```

## Documentation/devicetree/bindings/devfreq/nx-devfreq.txt
```
Nexell S5Pxx18 series SoC devfreq Device Tree bindings
======================================================

The Nexell S5Pxx18 series SoCs can change bus clock dynamically with this driver.

Required properties:
- compatible	: must contain "nexell,s5pxx18-devfreq"
- pll		: the number of pll that is origin of bus clock
- supply_name	: the name of target supply that is changed dynamically,
		  always "vdd_arm_regulator"
- vdd_arm_regulator-supply : reference to regulator node
- status	: default is "disabled". when using, set to "okay"

Example:

        nx-devfreq {
	        compatible = "nexell,s5pxx18-devfreq";
	        pll = <0>;
		supply_name = "vdd_arm_regulator";
		vdd_arm_regulator-supply = <&VCC_DCDC1>;
	        status = "okay";
	};
```

## Documentation/devicetree/bindings/dma/arm-pl080.txt
```
* ARM PrimeCell PL080 DMA Controller

The ARM PrimeCell PL080 DMA controller can move blocks of memory contents
between memory and peripherals or memory to memory.

Required properties:
  - compatible: should include both "arm,pl080" and "arm,primecell".
  - reg: physical base address of the controller and length of memory mapped
    region.
  - interrupts: interrupt number to the cpu.

Optional properties:
  - dma-coherent : Present if dma operations are coherent
  - #dma-cells : must be <1>. used to represent the number of integer
    cells in the dmas property of client device.
  - arm,primecell-periphid : Value to override the h/w value with
  - master_lli_buses : buses which LLIs can be fetched from: PL08X_AHB1 | PL08X_AHB2
  - master_mem_buses : buses which memory can be accessed from: PL08X_AHB1 | PL08X_AHB2
  - memcpy_bus_id : name of this device channel, not just a device name since
    devices may have more than one channel e.g. "foo_tx"
  - memcpy_cctl : options for the channel control register for memcpy
  - slave_bus_id : name of this device channel, not just a device name since
    devices may have more than one channel e.g. "foo_tx"
  - slave_min_signal : the minimum DMA signal number to be muxed in for this
    channel (for platforms supporting muxed signals). If you have
    static assignments, make sure this is set to the assigned signal
    number, PL08x have 16 possible signals in number 0 thru 15 so
    when these are not enough they often get muxed (in hardware)
    disabling simultaneous use of the same channel for two devices.
  - slave_periph_buses : the device connected to this channel is accessible via
    these buses (use PL08X_AHB1 | PL08X_AHB2).
  - use_isr : use isr instead of tasklet.
  - slave_wait_flush_dma : wait until flush slave channel dma buffer.

Example:

	pl08xdma0:pl08xdma@00000 {
		compatible = "arm,pl080", "arm,primecell";
		reg = <0xC0000000 0x1000>;
		interrupts = <0 1 0>;
		#dma-cells = <1>;

		/* ID and bus config */
		arm,primecell-periphid = <0x00041080>;
		master_lli_buses = <PL08X_AHB1>;

		/* memeory copy config */
		master_mem_buses = <PL08X_AHB1>;
		memcpy_bus_id = "memcpy";
		memcpy_cctl = <(PL080_BSIZE_256 << PL080_CONTROL_SB_SIZE_SHIFT |\
			        PL080_BSIZE_256 << PL080_CONTROL_DB_SIZE_SHIFT |\
				PL080_WIDTH_32BIT << PL080_CONTROL_SWIDTH_SHIFT|\
				PL080_WIDTH_32BIT << PL080_CONTROL_DWIDTH_SHIFT|\
				PL080_CONTROL_PROT_BUFF |\
				PL080_CONTROL_PROT_CACHE |\
				PL080_CONTROL_PROT_SYS)>;
		/* slave channels */
		ch0 {
			slave_bus_id = "uart1_tx";
			slave_min_signal = <0>;
			slave_periph_buses = <PL08X_AHB2>;
		};

		ch1 {
		    slave_bus_id = "uart1_rx";
		    slave_min_signal = <1>;
		    slave_periph_buses = <PL08X_AHB2>;
		};
		/* add other channels information ... */
	};

Client drivers (device nodes requiring dma transfers from dev-to-mem or
mem-to-dev) should specify the DMA channel numbers and dma channel names
as shown below.

  [property name]  = <[phandle of the dma controller] [dma request id]>;
  [property name]  = <[dma channel name]>

      where 'dma request id' is the dma request number which is connected
      to the client controller. The 'property name' 'dmas' and 'dma-names'
      as required by the generic dma device tree binding helpers. The dma
      names correspond 1:1 with the dma request ids in the dmas property.

  Example:  dmas = <&pdma0 12
		    &pdma1 11>;
	    dma-names = "tx", "rx";
```

## Documentation/devicetree/bindings/drm/nexell/cluster_lcd.txt
```
Device-Tree bindings for Nexell DRM generic Cluster-LCD output driver

Required properties for display soc panel driver:
 - compatible: value should be "nexell,s5pxx18-drm-cluster-lcd.
 - cluster-hactive: cluster lcd horizontal active pixel
 - cluster-vactive: cluster lcd vertical active pixel
 - cluster-reference: cluster lcd sync reference node number to get
    backporch, frontporch, sync width, ....
 - width-mm: physical panel width [mm]
 - height-mm: physical panel height [mm]


  - lvds: sub node to config lvds panel refer to "lvds_panel.txt".
  - rgb : sub node to config rgb panel refer to "rgb_panel.txt".

Example:

SOC specific portion:

/ {
	...
	soc {
		dp_drm_cluster_lcd: display_drm_cluster_lcd {
    			compatible = "nexell,s5pxx18-drm-cluster-lcd";
		};
	};
};

Board Specific portion:

&dp_drm_cluster_lcd {
	cluster-hactive = <1920>;
	cluster-vactive = <720>;
	cluster-reference = <0>;

	lvds {
		.....
		display-timing {
        	.....
		};

		dp_control {
			.....
		};
	};

	rgb {
    	display-timing {
           .....
		};

		dp_control {
        	.....
		};
	};
};
```

## Documentation/devicetree/bindings/drm/nexell/gpu.txt
```
Device-Tree bindings for Nexell's DRM and display control driver

Required properties for display controller driver:
 - compatible: value should be "nexell,dp-s5p6818"

Required properties for LCD output driver:
 - compatible: value should be "nexell,dp-s5p6818-lcd"

Required properties for DRM driver:
 - compatible: value should be "nexell,drm-s5p6818"

Required properties for DRM sub LCD driver:
 - compatible: value should be "nexell,drm-s5p6818-lcd"

Example:

/ {
	...

	soc {
		dp-controller@N {
			compatible = "nexell,dp-s5p6818";
		};

		dp-controller@1 {
			compatible = "nexell,dp-s5p6818";
		};

		dp-out-lcd {
			compatible = "nexell,dp-s5p6818-lcd";
		};

		drm-subsystem {
			compatible = "nexell,drm-s5p6818";
		};

		drm-sub-lcd {
			compatible = "nexell,drm-s5p6818-lcd";
		};

};
```

## Documentation/devicetree/bindings/drm/nexell/hdmi.txt
```
Device-Tree bindings for Nexell DRM generic hdmi output driver

Required properties for display soc panel driver:
 - compatible: value should be "nexell,s5pxx18-drm-hdmi".
 - ddc-i2c-bus : phandle of an I2C controller used for DDC EDID probing
 - enable-gpios: GPIO pin to enable or disable the HDMI level shifter

 - mode: sub node to hdmi preferred
   - width: preferred width
   - height: preferred height
   - refresh: preferred refresh
optional property:
 - q_range: video quantization range
   	a) "0" limitied range
	b) "1" full range

Example:

SOC specific portion:

/ {
	...
	soc {
		dp_drm_hdmi: display_drm_hdmi {
    			compatible = "nexell,s5pxx18-drm-hdmi";
    			reg = <0xc0101000 0x100>;
    			resets = <&nexell_reset RESET_ID_DISP_TOP>;
    			reset-names = "rsc-display-top";
    			#address-cells = <1>;
    			#size-cells = <0>;
    			status = "disabled";

    			hdmi {
    				reg_base = <0xc0000000 0x300000>;
    				clk_base = <0xc0109000 4>, <0xc0105000 2>;
    				resets = <&nexell_reset RESET_ID_HDMI_VIDEO>,
    					<&nexell_reset RESET_ID_HDMI_SPDIF>,
    					<&nexell_reset RESET_ID_HDMI_TMDS>,
    					<&nexell_reset RESET_ID_HDMI>,
    					<&nexell_reset RESET_ID_HDMI_PHY>;
    				reset-names = "rsc-hdmi-video", "rsc-hdmi-spdif",
    					"rsc-hdmi-tmds", "rsc-hdmi", "rsc-hdmi-phy";
    					soc,tieoff = <NX_TIEOFF_DISPLAYTOP0_i_HDMI_PHY_REFCLK_SEL 1>;
    			};
		};
	};
};

Board Specific portion:

&dp_drm_hdmi {
	ddc-i2c-bus = <&i2c_gpio7>;
	enable-gpios = <&gpio_a 21 0>;
	status = "ok";
	q_range = <0>;

	mode {
		width = <1280>;
		height = <720>;
		refresh	= <60>;
	};
};
```

## Documentation/devicetree/bindings/drm/nexell/mipi_panel.txt
```
Device-Tree bindings for Nexell DRM generic RGB panel output driver

Required properties for display soc panel driver:
 - compatible: value should be "nexell,s5pxx18-drm-mipi".
 - remote-endpoint: the mipi lcd-panel node can contain one 'port' child node
    with one child 'endpoint' node, according to the bindings defined in [2]. This
    node should describe panel's video bus.
 - width-mm: physical panel width [mm]
 - height-mm: physical panel height [mm]
 - display-timing: typical videomode of lcd panel. Multiple video modes
    can be listed if the panel supports multiple timings, but the 'native-mode'
    should be the preferred/default resolution.  Refer to
    Documentation/devicetree/bindings/video/display-timing.txt for display
    timing binding details.

 - hs_bitrate: mipi high speed bitrate (1000, ... Mhz) to mipi data         
 - lp_bitrate: mipi low power bitrate (150, 100, 80 Mhz) to setup data

  - dp_control: sub node to config display port hw parameters.
   - clk_src_lv0: select display clock source of clock generator '0'
      0:PLL0, 1:PLL1, 2:SVLCK, 3:P(S)VCLK, 4:~P(S)VCLK, 5:AVCLK
      6:~SVLCK, 7:ClKGEN0's Output( Only use Clock generator1 )
   - clk_div_lv0: set display clock divisor of specified clock generator '0' (1 ~ 256)
   - clk_src_lv1: select display clock source of clock generator '1'
      0:PLL0, 1:PLL1, 2:SVLCK, 3:P(S)VCLK, 4:~P(S)VCLK, 5:AVCLK
      6:~SVLCK, 7:ClKGEN0's Output( Only use Clock generator1 )
   - clk_div_lv1: set clock display divisor of specified clock generator '1' (1 ~ 256)
   - out_format: specifies display out data format
   - invert_field: pecifies internal field polarity
      0: normal field(low is odd), 1: invert field(low is even)
   - swap_rb: swap red and blue component for rgb output
   - yc_order: output order for YCbCr Output
   - delay_mask: to adjust delay (rgb_pvd, hsync_cp1, vsync_fram, de_cp2)
      if 0, set defalut delays
   - d_rgb_pvd: the delay value for RGB/PVD signal
   - d_hsync_cp1: the delay value for HSYNC/CP1 signal
   - d_vsync_fram: the delay value for VSYNC/FRAM signal
   - d_de_cp2: the delay value for DE/CP2 signal
   - vs_start_offset: start veritcal sync offset
   - vs_end_offset: end veritcla sync offset
   - ev_start_offset: start even veritcal sync offset
   - ev_end_offset: end even veritcal sync offset
   - vck_select: specifies the pixel clock polarity

Example:

SOC specific portion:

/ {
	...
	soc {
		dp_drm_mipi: display_drm_mipi {
    			compatible = "nexell,s5pxx18-drm-mipi";
		};
	};
};

Board Specific portion:

&dp_drm_mipi {
	remote-endpoint = <&mipi_panel>;
	hs_bitrate = <960>;
	lp_bitrate = <100>;

	display-timing {
	        clock-frequency = <65000000>;
        	hactive = <1024>;
	        hsync-len = <20>;
        	hback-porch = <160>;
	        hfront-porch = <160>;
        	hsync-active = <1>;
	        vactive = <600>;
	        vsync-len = <3>;
        	vback-porch = <23>;
	        vfront-porch = <12>;
	        vsync-active = <1>;
	};

	dp_control {
		clk_src_lv0 = <0>;
		clk_div_lv0 = <16>;
		clk_src_lv1 = <7>;
		clk_div_lv1 = <1>;
		.....
	};
    };
};
```
