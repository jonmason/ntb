## Documentation/devicetree/bindings/media/nexell-decimator.txt
```
Nexell V4L2 Device Tree bindings
================================

Decimator can scale down input image and saves to memory.
Normally this function is same to pip-preview function.

Required properties:
- compatible	: must contain "nexell,nx-decimator"
- module	: vip module number
- status	: to enable, must contain "okay"

Example:
	decimator {
		compatible = "nexell,nx-decimator";
		module = <1>;
		status = "okay";
	};
```

## Documentation/devicetree/bindings/media/nexell-mpegts.txt
```
Nexell Rear MPEGTS Device Tree bindings
====================================

MPEGTS is for receiving ISDB-T broadcasts.

Required properties:
- compatible	: must contain "nexell,nx-mpegts"
- reg		: the register sets (physical address and length) for the MPEGTS
- reset-names	: the MPEGTS reset specifier
- resets       	: the reset reference for MPEGTS. must use value defined in reset dts
- clock-names  	: the MPEGTS clock specifier
- clocks        : the clock reference for MPEGTS. must use value defined in clock dts
- channel_num	: the channel number for MPEGTS. this value depend on hardware settting
- status	: default is "disabled". when using, set to "okay"
- pinctrl-names : must contain "default"
- pinctrl-0     : the pinctrl reference to MPEGTS channel and operation mothod(serrial and parallel)
- gpios		: the MPEGTS gpio settings for power control
- serial_mode	: set MPEGTS serial mode(1 : serial mode, 0 : parallel mode)
- clock_pol	: set operation clock polarity for the MPEGTS(1 : high, 0 : low)
- valid_pol	: set operation validation polarity for the MPEGTS(1 : high, 0 : low)
- sync_pol	: set operation syncronazation polarity for the MPEGTS(1 : high, 0 : low)
- err_pol	: set operation error polarity for the MPEGTS(1 : high, 0 : low)
- bypass	: set stream bypass(1 : enable bypass, 0 : disable bypass)
- xfer_mode	: set output mode(1 : enable output mode, 0 : disable output mode)
- xfer_clk_pol	: set output clock polarity(1 : high, 0 : low)
- encrypt_on	: set whether to encrypt stream data.

Optional properties:
- power: enable_seq	: MPEGTS power on sequence
			  [ACTION_START_TAG][ACTION_TYPE][SEQUENCE][ACTION_END_TAG]
			  ACTION_START_TAG : NX_ACTION_START
			  ACTION_END_TAG : NX_ACTION_END
			  ACTION_TYPE : NX_ACTION_TYPE_PMIC, NX_ACTION_TYPE_GPIO, NX_ACTION_TYPE_CLOCK
			  SEQUENCE for ACTION_TYPE_GPIO: gpionum, value, delay_ms, value, delay_ms ...
			  SEQUENCE for ACTION_TYPE_PMIC: regulator_name, value, delay_ms
			  SEQUENCE for ACTION_TYPE_CLOCK: enable/disable, delay_ms

Example:
	mpegts_1: mpegts1@c005d000 {
		compatible = "nexell,nx-mpegts";
		reg = <0xc005d000 0x4000>;
		reset-names = "mpegts1-rst";
		resets = <&nexell_reset RESET_ID_MPEGTSI>;
		clock-names = "mpegts1-clk";
		clocks = <&mpegtsi>;
		channel_num = <1>;
		status = "disabled";
	};


	&mpegts_1 {
		status = "ok";
		pinctrl-names = "default";
		pinctrl-0 = <&mpegts_cap1_sync &mpegts_cap1_data_clk_serial>;
		gpios = <&gpio_a 23 0>;
		serial_mode = <1>;
		clock_pol = <1>;
		valid_pol = <1>;
		sync_pol = <1>;
		err_pol = <1>;
		bypass = <1>;
		xfer_mode = <0>;
		xfer_clk_pol = <0>;
		encrypt_on = <0>;

		power {
			enable_seq = <
			NX_ACTION_START NX_ACTION_TYPE_GPIO 0 1 1 0 1 1 1 NX_ACTION_END
			>;
	};
};
```

## Documentation/devicetree/bindings/media/nexell-rearcam.txt
```
Nexell Rear Camera Device Tree bindings
====================================

Rear Camea is to operate the camera and outputting a rear quickly through the
GPIO when the rear gear operation.

Required properties:
- compatible		: must contain "nexell,nx-rearcam"
- interrupts		: the DPC interrupt-number specifier for Rear Camera
- interrupts-names	: the DPC interrupt-name specifier for Rear Camera
- status		: default is "disabled". when using, set to "okay"

- rotation		: the display rotation property.
			  values: <0> - Not rotate.
			  	  <1> - Rotation.
- rear_cam_dev		: the VIP settting property.
			  It refers to the setting of the clipper already declared.
- display		: the display system settting property.
			  It refers to the display setting that has already been declared.
- dp_drm_dev		: the display device setting property.
			  It refers to the display device setting that already been declared.
- width			: the width for display image.
- height		: the height for display image.

Optional properties:
- gpio: event-gpio	: the GPIO for rear gear detection.
- gpio: active_high 	: Select wherher a high status for rear gear detection GPIO.
			  values: <0> - low activation.
			       	  <1> - high activation.
- gpio: detect_delay	: Delays in setting up the operation of the rear cmaera
			  after the detection for the rear gear.

- mlc: module		: the MLC moudule number to display.
- mlc: format		: the MLC format for rgb display.

- dpc: module		: the DPC module number to display


Example:

	rearcam: rear_camera {
		compatible = "nexell,nx-rearcam";
		interrupts = <IRQ_VIP0>, <IRQ_VIP1>;
		interrupts-names = "vip.0", "vip.1";
		status = "disabled";
	};

	&rearcam {
		rotation = <0>;
		rear_cam_dev = <&clipper_1>;
		sensor_reg = <&sensor_tw9900>;
		display = <&dp_drm>;
		dp_drm_dev = <&dp_drm_lvds>;
		width = <704>;
		height = <480>;
		status = "okay";

		gpio {
			event-gpio = <&alive_0 3 0>;
			active_high = <0>;
			detect_delay = <0>;
		};

		mlc {
			module = <0>;
			format = <0x06530000>;
		};

		dpc {
			module = <0>;
		};
	};
```

## Documentation/devicetree/bindings/media/nexell-v4l2.txt
```
Nexell V4L2 Device Tree bindings
================================

nx-v4l2 driver is top logical driver for all v4l2 devices of Nexell.

Required properties:
- compatible : must contain "nexell,nx-v4l2"
- status : To enable nx-v4l2, should set to "okay"

Example:

nx-v4l2 {
    compatible = "nexell,nx-v4l2";
    status = "okay";
};
```

## Documentation/devicetree/bindings/media/nexell-video-codec.txt
```
Nexell V4L2 Video Codec Device Tree bindings
=============================================

nx-vpu driver is top logical driver for all video codec of Nexell.

Required properties:
- compatible : must contain "nexell, nx-vpu"
- status : To enable nx-vpu, should set to "okay"
- sram : To enable SRAM, should set to <0xFFFF0000 0x8000>
         (base_address size)

Example:

video-codec@c0080000 {
	compatible = "nexell, nx-vpu";
	reg = <0xc0080000 0x4000>;
	interrupts = <0 IRQ_CODA960_HOST 0>;
	resets = <&nexell_reset RESET_ID_CODA_A>,
		<&nexell_reset RESET_ID_CODA_P>,
		<&nexell_reset RESET_ID_CODA_C>;
	reset-names = "vpu-a-reset", "vpu-p-reset", "vpu-c-reset";
	clocks = <&pclk>, <&bclk>;
	status = "okay";
	sram = <0xFFFF0000 0x8000>;
};
```

## Documentation/devicetree/bindings/media/nexell-vip.txt
```
Nexell V4L2 VIP Device Tree bindings
====================================

VIP is Video Input Processor.
The DT definitions can be found in include/dt-bindings/media/nexell-vip.h

Required properties:
- compatible	: must contain "nexell,vip"
- reg		: the two register sets (physical address and length) for the VIP
- interrupts	: ths VIP interrupt specifier
- clock-names	: the VIP clock specifier
- clocks	: the clock reference for VIP. must use value defined in clock dts
- reset-names	: the VIP reset specifier
- resets	: the reset reference for VIP. must use value defined in reset dts
- module	: the VIP module number
- status	: default is "disabled". when using, set to "okay"

Example:

	nxvip0:vip@c0063000 {
		compatible = "nexell,vip";
		reg = <PHYS_BASE_VIP0 0x1000>;
		interrupts = <0 IRQ_VIP1 0>;
		clock-names = "vip0";
		clocks = <&vip0>;
		reset-names = "vip0-reset';
		resets = <&nexell_reset RESET_ID_VIP0>;
		module = <0>;
		status = "okay";
	};
```

## Documentation/devicetree/bindings/mfd/axp228.txt
```
X-Powers AXP228 Multi-Function Device

The X-Powers AXP228 is a multi-function device which includes voltage/current
regulators, real time clock, battery charging controller and several
other sub-blocks. It is interfaced using an I2C interface. Each sub-block
is addressed by the host system using different i2c slave address.

AXP228 additionally contains PMIC (with DCDC/LDO regulators), charger and Fuel Gauge.


Required properties:
- compatible : Must be "x-powers,axp228".
- reg : I2C slave address for the axp228 chip.
- nx,irq : IRQ line for the chip.
- nx,irq_base : The sub interrupt controller.
- nx,irq_type : IRQ line status.


Example:

#include <dt-bindings/interrupt-controller/irq.h>

#define PMIC_PDATA_INIT(_id, _rname, _minuv, _maxuv, _always_on, _boot_on,	\
						_init_uv, _init_enable, _slp_slots)	\
		regulator-name = _rname;					\
		regulator-min-microvolt = <_minuv>;			\
		regulator-max-microvolt = <_maxuv>;			\
		nx,id = <_id>;								\
		nx,always_on = <_always_on>;				\
		nx,boot_on = <_boot_on>;					\
		nx,init_enable = <_init_enable>;			\
		nx,init_uV = <_init_uv>;					\
		nx,sleep_slots = <_slp_slots>;

axp228@34 {
	compatible = "x-powers,axp228";
	reg = <0x34>;
	interrupt-parent = <&alive_0>;
	interrupts = <0x4 IRQ_TYPE_EDGE_FALLING>;
	nx,id = <0>;
	/* vdd_arm-supply = <&VCC1P1_ARM_PMIC>; */
	/* vdd_core-supply = <&VCC1P0_CORE_PMIC>; */
	regulators {
		VCC_LDO1:
			axp22_rtcldo
			{ PMIC_PDATA_INIT( 0,
			"axp228_rtcldo",
			3000000, 3000000, 0, 0, 3300000,
			0, 0xF) };
		VCC_LDO2:
			axp22_aldo1
			{ PMIC_PDATA_INIT( 1,
			"axp228_3p3_alive",
			700000, 3300000, 1, 1, 3300000,
			1, 0xF) };
		VCC_LDO3:
			axp22_aldo2
			{ PMIC_PDATA_INIT( 2,
			"axp228_1p8_alive",
			700000, 3300000, 1, 1, 1800000,
			1, 0xF) };
		VCC_LDO4:
			axp22_aldo3
			{ PMIC_PDATA_INIT( 3,
			"axp228_1p0_alive",
			700000, 3300000, 1, 1, 1000000,
			1, 0xF) };
		VCC_LDO5:
			axp22_dldo1
			{ PMIC_PDATA_INIT( 4,
			"axp228_wide",
			700000, 3300000, 1, 1, 3300000,
			1, 0xF) };
		VCC_LDO6:
			axp22_dldo2
			{ PMIC_PDATA_INIT( 5,
			"axp228_1p8_cam",
			700000, 3300000, 0, 0, 1800000,
			0, 0xF) };
		VCC_LDO7:
			axp22_dldo3
			{ PMIC_PDATA_INIT( 6,
			"axp228_dldo3",
			700000, 3300000, 0, 0,  700000,
			0, 0xF) };
		VCC_LDO8:
			axp22_dldo4
			{ PMIC_PDATA_INIT( 7,
			"axp228_dldo4",
			700000, 3300000, 0, 0,  700000,
			0, 0xF) };
		VCC_LDO9:
			axp22_eldo1
			{ PMIC_PDATA_INIT( 8,
			"axp228_1p8_sys",
			700000, 3300000, 1, 1, 1800000,
			1, 0xF) };
		VCC_LDO10:
			axp22_eldo2
			{ PMIC_PDATA_INIT( 9,
			"axp228_3p3_wifi",
			700000, 3300000, 1, 1, 3300000,
			1, 0xF) };
		VCC_LDO11:
			axp22_eldo3
			{ PMIC_PDATA_INIT(10,
			"axp228_eldo3",
			700000, 3300000, 0, 0,  700000,
			0, 0xF) };
		VCC_LDO12:
			axp22_dc5ldo
			{ PMIC_PDATA_INIT(11,
			"axp228_1p2_cvbs",
			700000, 1400000, 0, 0, 1200000,
			0, 0xF) };
		VCC_DCDC1:
			axp22_dcdc1
			{ PMIC_PDATA_INIT(12,
			"axp228_3p3_sys",
			1600000, 3400000, 1, 1, 3300000,
			1, 0xF) };
		VCC1P1_ARM_PMIC:
			axp22_dcdc2
			{ PMIC_PDATA_INIT(13,
			"axp228_1p1_arm",
			600000, 1540000, 1, 1, 1100000,
			1, 0xF) };
		VCC1P0_CORE_PMIC:
			axp22_dcdc3
			{ PMIC_PDATA_INIT(14,
			"axp228_1p0_core",
			600000, 1860000, 1, 1, 1100000,
			1, 0xF) };
		VCC_DCDC4:
			axp22_dcdc4
			{ PMIC_PDATA_INIT(15,
			"axp228_1p5_sys",
			600000, 1540000, 1, 1, 1500000,
			1, 0xF) };
		VCC_DCDC5:
			axp22_dcdc5
			{ PMIC_PDATA_INIT(16,
			"axp228_1p5_ddr",
			1000000, 2550000, 1, 1, 1500000,
			1, 0xF) };
		VCC_LDOIO0:
			axp22_ldoio0
			{ PMIC_PDATA_INIT(17,
			"axp228_ldoio0",
			700000, 3300000, 0, 0, 1800000,
			0, 0xF) };
		VCC_LDOIO1:
			axp22_ldoio1
			{ PMIC_PDATA_INIT(18,
			"axp228_ldoio1",
			700000, 3300000, 0, 0, 1000000,
			0, 0xF) };
	};
};
```

## Documentation/devicetree/bindings/mfd/nxe2000.txt
```
NEXELL NXE2000 Multi-Function Device

The NEXELL NXE2000 is a multi-function device which includes voltage/current
regulators, real time clock, battery charging controller and several
other sub-blocks. It is interfaced using an I2C interface. Each sub-block
is addressed by the host system using different i2c slave address.

NXE2000 additionally contains PMIC (with DCDC/LDO regulators), charger and Fuel Gauge.


Required properties:
- compatible : Must be "nexell,nxe2000" or "nexell,nxe1500".
- reg : I2C slave address for pmic.
- nx,irq : IRQ line for the chip.
- nx,irq_base : The sub interrupt controller.
- nx,irq_type : IRQ line status.


Example:

#include <dt-bindings/interrupt-controller/irq.h>

#define PMIC_PDATA_INIT(_id, _rname, _minuv, _maxuv, _always_on, _boot_on,	\
						_init_uv, _init_enable, _slp_slots)	\
		regulator-name = _rname;					\
		regulator-min-microvolt = <_minuv>;			\
		regulator-max-microvolt = <_maxuv>;			\
		nx,id = <_id>;								\
		nx,always_on = <_always_on>;				\
		nx,boot_on = <_boot_on>;					\
		nx,init_enable = <_init_enable>;			\
		nx,init_uV = <_init_uv>;					\
		nx,set_init_uV = <_set_init_uV>;			\
		nx,sleep_slots = <_slp_slots>;

nxe1500@32 {
	compatible = "nexell,nxe1500";
	reg = <0x32>;
	interrupt-parent = <&alive_0>;
	interrupts = <0x5 IRQ_TYPE_EDGE_FALLING>;
	regulators {
		VCC_DCDC0:
			dcdc1	{ PMIC_PDATA_INIT( 0,
				"nxe2000_dcdc1",
				900000, 1500000,
				1, 1, 1100000,
				1, 0, 0x4) };
		... ... ...
		VCC_DCDC4:
			dcdc5	{ PMIC_PDATA_INIT( 4,
				"nxe2000_dcdc5",
				1000000, 2000000,
				1, 1, 1500000,
				1, 0, 0x4) };
		VCC_LDO0:
			ldo1	{ PMIC_PDATA_INIT( 5,
				"nxe2000_ldo1",
				1000000, 3500000,
				0, 0, 3300000,
				0, 1, 0x0) };
		... ... ...
		VCC_RTC1:
			ldortc2	{ PMIC_PDATA_INIT(16,
				"nxe2000_rtc2",
				1000000, 3500000,
				1, 1, 1000000,
				1, 1, 0xF) };
	};
};

nxe2000@32 {
	compatible = "nexell,nxe2000";
	reg = <0x32>;
	interrupt-parent = <&alive_0>;
	interrupts = <0x5 IRQ_TYPE_EDGE_FALLING>;
	regulators {
		VCC_DCDC0:
			dcdc1	{ PMIC_PDATA_INIT( 0,
				"nxe2000_dcdc1",
				900000, 1500000,
				1, 1, 1100000,
				1, 0, 0x4) };
		... ... ...
		VCC_DCDC4:
			dcdc5	{ PMIC_PDATA_INIT( 4,
				"nxe2000_dcdc5",
				1000000, 2000000,
				1, 1, 1500000,
				1, 0, 0x4) };
		VCC_LDO0:
			ldo1	{ PMIC_PDATA_INIT( 5,
				"nxe2000_ldo1",
				1000000, 3500000,
				0, 0, 3300000,
				0, 1, 0x0) };
		... ... ...
		VCC_RTC1:
			ldortc2	{ PMIC_PDATA_INIT(16,
				"nxe2000_rtc2",
				1000000, 3500000,
				1, 1, 1000000,
				1, 1, 0xF) };
	};
};
```
