## Documentation/devicetree/bindings/drm/nexell/nexell_display.txt
```
Device-Tree bindings for Nexell's DRM and display control driver

Required properties for display controller driver:
 - compatible: value should be "nexell,s5pxx18-dp_drm"
 - reg: Physical base address and length of the controller's registers.
 - interrupts: The interrupt signals from the display controller.
 - resets: The reset signal to the display controller.

 - ports: sub node to config crtc(multi layer control:MLC) info
  - port@0,1: logical crtc sub node

   - reg: hw crtc index.
   - back_color: top layer's background color
   - color_key: video layer's color key value
   - plane-names: multi layer's type and order ("primary", "cursor", "rgb", "video")

Example:

SOC specific portion:
/ {
	...
	soc {
		...
		dp_drm: display_drm {
			compatible = "nexell,s5pxx18-drm";
			reg = <0xc0102800 0x100>, <0xc0102c00 0x100>,
				  <0xc0102000 0x100>, <0xc0102400 0x100>;
			reg-names = "dpc.0", "dpc.1", "mlc.0", "mlc.1";
			interrupts = < 0 IRQ_DPC_P 0 >, <0 IRQ_DPC_S 0>;
			interrupts-names = "dpc.0", "dpc.1";
			reset-names = "rsc-display", "rsc-display-top";
			resets = <&nexell_reset RESET_ID_DISPLAY>,
           	reset-names = "rsc-display";

			ports {
				#address-cells = <0x1>;
				#size-cells = <0>;
				port@0 { };
				port@1 { };
			};
		};
		...
	};
	...
};

Board Specific portion:
&dp_drm {
	status = "okay";
	ports {
		port@0 {
			reg = <0>;
			back_color = < 0x0 >;
			color_key = < 0x0 >;
			plane-names = "video", "primary", "rgb";
		};

		port@1 {
			reg = <1>;
			back_color = < 0x0 >;
			color_key = < 0x0 >;
			plane-names = "video", "primary";
		};
	};
};
```

## Documentation/devicetree/bindings/drm/nexell/tvout.txt
```
Device-Tree bindings for Nexell DRM generic tvout output driver

Required soc properties for tvout display :
 - compatible: value should be "nexell,s5pxx18-drm-tv".
 - reg: Physical base address and length of the controller's registers.
 - resets: The reset signal to the display controller.
 - reset-names: Alias string resets options.
 - status: Indicates whether the operation.

	*. sub tree of "dp-resource" property
	- reg_base: Physical base address and length of the hdmi configuation
	            register.
	- clk_base: Physical base address and length of the hdmi clock.
		    configuration register.
	- resets: The reset signal to the each hdmi block.
	- reset-names: Alias string resets options.
	- soc,tieoff: select tieoff reference clock.

  ex)
   / {
	...
	soc {
		...

		dp_drm_tvout: display_drm_tv{
			compatible = "nexell,s5pxx18-drm-tv";
			reg = <0xc0101000 0x100>;
			resets = <&nexell_reset RESET_ID_DISP_TOP>;
			reset-names = "rsc-display-top";
			#address-cells = <1>;
			#size-cells = <0>;
			status = "disabled";

			dp-resource {
				reg_base = <0xc0000000 0x300000>;
				clk_base = <0xc0109000 4>;
				resets = <&nexell_reset RESET_ID_HDMI_VIDEO>,
				<&nexell_reset RESET_ID_HDMI_SPDIF>,
				<&nexell_reset RESET_ID_HDMI_TMDS>,
				<&nexell_reset RESET_ID_HDMI>,
				<&nexell_reset RESET_ID_HDMI_PHY>;
				reset-names = "rsc-hdmi-video", "rsc-hdmi-spdif",
				"rsc-hdmi-tmds", "rsc-hdmi", "rsc-hdmi-phy";
				soc,tieoff = <NX_TIEOFF_DISPLAYTOP0_i_HDMI_PHY_REFCLK_SEL 1>;
			};
		};

		...
	};
    };

Required board properties for tvout display :
 - pinctrl-names: Alias string "pinctrl-0" option
 - pinctrl-0: set pin function for tvout
	      (tvout clock and data pin setting)
 - status: Indicates whether the operation

	*. Sub tree of "display-timing" property
	The videomode of TV-OUT panel.
	TVOUT setting value should be set to a predetermined value the
	selection device.

	Refer to Documentation/devicetree/bindings/video/display-timing.txt for
	display timing binding details.

	*. Sub tree of "dp_control" property
	- clk_src_lv0: select display clock source of clock generator '0'
	  0:PLL0, 1:PLL1, 2:PLL2, 3:none, 4:HDMI PLL Clock, 5:none
	  6:PLL3, 7:Reserved.
	- clk_div_lv0: set display clock divisor of specified
	  clock generator '0' (1 ~ 256)
	- clk_delay_lv0: set delay value of the source clock output '0'.
	  This value is needed to adjust clock skew with respect to data signal.
	- clk_inv_lv0: Specifies whether to invert the source clock output '0'.
	- clk_src_lv1: select display clock source of clock generator '1'
	  0:PLL0, 1:PLL1, 2:PLL2, 3:none, 4:HDMI PLL Clock, 5:none
	  6:PLL3, 7:Reserved.
	- clk_div_lv1: set display clock divisor of specified
	  clock generator '1' (1 ~ 256)
	- clk_delay_lv1: set delay value of the source clock output '1'.
	  This value is needed to adjust clock skew with respect to data signal.
	- clk_inv_lv1: Specifies whether to invert the source clock output '1'.
	- vck_select: specifies the pixel clock polarity.
	- out_format: specifies display out data format.

	*. Sub tree of "sensor" property
	- register: specifies register address and value tvout sensor
		ex) <register address, register value>
	- i2c_name: TVOUT sensor name to register I2C.
	- i2c_adapter: I2C apapter number associated with the TVOUT device.
        - addr: specifies i2c deivce address for TVOUT sensor.


	ex) Use hdmi clock(27MHz)
	&dp_drm_tvout {
		pinctrl-names = "default";
		pinctrl-0 = <&dp_rgb_vclk &dp_rgb_G>;
		status = "ok";

		display-timing {
			clock-frequency = <27000000>;
			hactive = <720>;
			vactive = <240>;
			hfront-porch = <16>;
			hback-porch = <60>;
			hsync-len = <62>;
			vfront-porch = <4>;
			vback-porch = <15>;
			vsync-len = <3>;
			interlaced = <1>;
			vsync-active = <0>;
			hsync-active = <0>;
		};

		dp_control {
			clk_src_lv0 = <4>;
			clk_div_lv0 = <1>;
			clk_delay_lv0 = <0>;
			clk_inv_lv0 = <1>;
			clk_src_lv1 = <7>;
			clk_div_lv1 = <2>;
			clk_delay_lv1 = <0>;
			clk_inv_lv1 = <1>;
			vck_select = <1>;
			out_format = <10>;
		};

		sensor {
			register = <0x87 0x20>, <0x88 0x00>, <0x8A 0x08>;
			i2c_name = "adv7393";
			i2c_adapter = <5>;
			addr = <0x2a>;
		};
	};

	ex) Use pll0(270MHz/10) clock(27MHz)
	*. Use PLL0(270MHz/10=27MHz) Clock
            &dp_drm_tvout {
                    pinctrl-names = "default";
                    pinctrl-0 = <&dp_rgb_vclk &dp_rgb_G>;
                    status = "ok";

                    display-timing {
                            clock-frequency = <27000000>;
                            hactive = <720>;
                            vactive = <240>;
                            hfront-porch = <16>;
                            hback-porch = <60>;
                            hsync-len = <62>;
                            vfront-porch = <4>;
                            vback-porch = <15>;
                            vsync-len = <3>;
                            interlaced = <1>;
                            vsync-active = <0>;
                            hsync-active = <0>;
                    };

                    dp_control {
                            clk_src_lv0 = <0>;
                            clk_div_lv0 = <10>;
                            clk_delay_lv0 = <0>;
                            clk_inv_lv0 = <1>;
                            clk_src_lv1 = <7>;
                            clk_div_lv1 = <2>;
                            clk_delay_lv1 = <0>;
                            clk_inv_lv1 = <1>;
                            clk_sel_div1 = <0>;
                            vck_select = <1>;
                            out_format = <10>;
                    };

                    sensor {
                            register = <0x87 0x20>, <0x88 0x00>, <0x8A 0x08>;
                            i2c_name = "adv7393";
                            i2c_adapter = <5>;
                            addr = <0x2a>;
                    };
            };
```

## Documentation/devicetree/bindings/i2c/i2c-nx.txt
```
* Nexell's I2C controller

The Nexell's I2C controller is used to interface with I2C devices.

Required properties:
  - compatible: value should be either of the following.
      (a) "nexell, s5p4418-i2c", for i2c compatible with s5p4418 i2c.
  - reg: physical base address of the controller and length of memory mapped
    region.
  - interrupts: interrupt number to the cpu.
  - clock-names : shall be "i2c"
  - clocks : clock provider specifier
  - resets : phandle to the parent reset controller.(only Nexell Soc.)
      - "nexell_reset" - reset-controller,
      - "RESET_ID_I2C0" - Nth Reset control id (N = 0, 1, ...)
  - reset-names : input names of resets used by the controller(only Nexell Soc.)
  - gpios: The order of the gpios should be the following: <SDA, SCL>.
  - pinctrl-names: Should contain only one value - "default".
  - pinctrl-0: Pin control group(i2c mode) to be used for this controller.
  - pinctrl-1: Pin control group(gpio mode) to be used for this controller.

Optional properties:
  - sda-delay: Delay (in us) to set delay between sda and scl when start/stop.
  - retry-delay: Delay (in us) to retry data transfer.
  - retry-cnt: retry times to retry data transfer.
  - rate: Desired frequency in Hz of the bus.
    If not specified, the default value in Hz is 100000.

Example:

	i2c_0:i2c@c00a4000 {
		compatible = "nexell,s5p4418-i2c";
		reg = <PHYS_BASE_I2C0 0x100>;
		interrupts = <IRQ_I2C0>;
		clock-names = "i2c";
		clocks = <&i2c0>;
		resets  = <&nexell_reset RESET_ID_I2C0>;
		reset-names = "i2c-reset";
		gpios = <&gpio_d 3 0 /* SDA */
			 &gpio_d 2 0 /* SCL */>;
		pinctrl-names = "default", "mode_gpio";
		pinctrl-0 = <&i2c0_pin_dft>;
		pinctrl-1 = <&i2c0_gpio_mode>;
		sda-delay = <1>;
		retry-delay = <100>;
		retry-cnt = <3>;
		rate = <100000>;
		#address-cells = <1>;
		#size-cells = <0>;

		es8316: es8316@11 {
			compatible = "everest,es8316";
			reg = <0x11>;
		};
	};
```

## Documentation/devicetree/bindings/iio/adc/nexell,adc.txt
```
Nexell's Analog to Digital Converter (ADC)

The devicetree bindings are for the ADC driver written for Nexell's ADC.

When the sampling is done, interrupt is rised, and then read the value.
Please refer to the datasheet for more information.


Required properties:
  - compatible: Should be "nexell,<chip>-adc"
    <chip> can be "s5p4418", "s5p6818"
  - reg: Should contain ADC registers location and length
  - interrupts: Should contain the IRQ line for the ADC
  - clocks : From common clock bindings - handles to clocks specified in
        "clock-names" property, in the same order.
  - clock-names: From common clock bindings - list of clock input names used by
        ADC block. Should contain "adc"
  - sample_rate: ADC channel sampling rate. (Max 1MHz according to datasheet)
  - #io-channel-cells: <1> - As ADC has multiple outputs.
        For details about this, see:
            Documentation/devicetree/bindings/iio/iio-bindings.txt


Example:
	adc:adc@c0053000 {
		compatible = "nexell,s5p6818-adc";
		reg = <PHYS_BASE_ADC 0x1000>;
		interrupts = <0 IRQ_ADC 0>;
		resets = <&nexell_reset RESET_ID_ADC>;
		reset-names = "adc-reset";
		clocks = <&pclk>;
		clock-names = "adc";
		sample_rate = <200000>;
		#io-channel-cells = <1>;
	};

Example:
	adc:adc@c0053000 {
		compatible = "nexell,s5p4418-adc";
		reg = <PHYS_BASE_ADC 0x1000>;
		resets = <&nexell_reset RESET_ID_ADC>;
		reset-names = "adc-reset";
		clocks = <&pclk>;
		clock-names = "adc";
		sample_rate = <200000>;
		#io-channel-cells = <1>;
	};
```

## Documentation/devicetree/bindings/media/fci-fc8300.txt
```
FCI FC8300 MODULE Device Tree bindings
======================================

FCI FC8300 is a de-module for receiving ISDB-T broadcasts.

Required properties:
- compatible	: must contain "fci,fc8300_i2c"
- reset-gpios	: GPIO specifier for the chips reset line
- reg		: the register sets (physical address and length) for the FC8300

Example:
	fc8300: fc8300@58 {
		compatible = "fci,fc8300_i2c";
		reset-gpios = <&gpio_c 12 0>;
		reg = <0x58>;
	};
```

## Documentation/devicetree/bindings/media/nexell-clipper.txt
```
Nexell V4L2 Clipper Device Tree bindings
========================================

Clipper clip vip input data and give data to decimator and
save clipped data to memory.
The DT definitions can be found in include/dt-bindings/media/nexell-vip.h

Required properties:
- compatible	: must contain "nexell,nx-clipper"
- module	: vip module number
- interface_type	: NX_CAPTURE_INTERFACE_PARALLEL or NX_CAPTURE_INTERFACE_MIPI
			  parallel interface is 8bit(656/601)
- pinctrl-names	: must contain "default"
- pinctrl-0	: the pinctrl reference to vid
- port		: vip input port, each vip has two input port and can use only one
- external_sync	: if 1, this is 601, else 656
- data_order	: YUV 422 data order from camera sensor
- interlace	: if 1, interlace input data
- sensor: type	: must contain NX_CAPTURE_SENSOR_I2C
- sensor: i2c_name	: camera sensor i2c type(name)
- sensor: i2c_adapter	: camera sensor i2c adapter number
- sensor: addr		: camera sensor i2c address

Optional properties:
- power: enable_seq	: camera sensor power on sequence
			  [ACTION_START_TAG][ACTION_TYPE][SEQUENCE][ACTION_END_TAG]
			  ACTION_START_TAG : NX_ACTION_START
			  ACTION_END_TAG : NX_ACTION_END
			  ACTION_TYPE : NX_ACTION_TYPE_PMIC, NX_ACTION_TYPE_GPIO, NX_ACTION_TYPE_CLOCK
			  SEQUENCE for ACTION_TYPE_GPIO: gpionum, value, delay_ms, value, delay_ms ...
			  SEQUENCE for ACTION_TYPE_PMIC: regulator_name, value, delay_ms
			  SEQUENCE for ACTION_TYPE_CLOCK: enable/disable, delay_ms
- clock: pwms	: reference to pwm that gives master clock to camera sensor

Example:
	clipper {
		compatible = "nexell,nx-clipper";
		module = <1>;
		interface_type = <NX_CAPTURE_INTERFACE_PARALLEL>;
		pinctrl-names = "default";
		pinctrl-0 = <&vid0_data_clk &vid0_sync> ;
		port = <0>;
		external_sync = <0>;
		data_order = <NX_VIN_Y0CBY1CR>;
		interlace = <0>;

		sensor {
			type = <NX_CAPTURE_SENSOR_I2C>;
			i2c_name = "SP2518";
			i2c_adapter = <0>;
			addr = <0x30>;
		};

		power {
			enable_seq = <
				NX_ACTION_START NX_ACTION_TYPE_PMIC 0 0 NX_ACTION_END
				NX_ACTION_START NX_ACTION_TYPE_PMIC 1 0 NX_ACTION_END
				NX_ACTION_START NX_ACTION_TYPE_GPIO 102 1 0 NX_ACTION_END
				NX_ACTION_START NX_ACTION_TYPE_GPIO 103 1 0 0 1 NX_ACTION_END
				NX_ACTION_START NX_ACTION_TYPE_GPIO 104 0 0 1 0 NX_ACTION_END
				NX_ACTION_START NX_ACTION_TYPE_CLOCK 1 10 NX_ACTION_END
				NX_ACTION_START NX_ACTION_TYPE_GPIO 104 0 10 NX_ACTION_END
				NX_ACTION_START NX_ACTION_TYPE_GPIO 103 1 5 NX_ACTION_END
				>;
		};

		clock {
			pwms = <&pwm_device1 0 24000000 0>
		};
	};
```

## Documentation/devicetree/bindings/media/nexell-csi.txt
```
Nexell V4L2 MIPI-CSI Device Tree bindings
=========================================

MIPI-CSI is connected to VIP internally.

Required properties:
- compatible	: must contain "nexell,mipi_csi"
- reg		: physical address and length
- clock-names	: clock specifier
- clocks	: clock reference. must use value defined in clock dts
- reset-names	: reset specifier
- resets	: reset reference to mipi, mipi_csi, mipi_phy_s
- data_lane	: camera sensor to mipi-csi data lane total number(1 ~ 4)
- swap_clocklane	: if 1, clocklane is swapped
- swap_datalane	: if 1, datalane is swapped
- pllval	: 750(750MHz) or 1000(1GHz). Internally used pll value
- status	: default is "disabled". when using, set to "okay"

Example:

	mipi_csi:mipi_csi@c00d0000 {
		compatible = "nexell,mipi_csi";
		reg = <PHYS_BASE_MIPI 0x1000>;
		clock-names = "mipi";
		clocks = <&mipi>;
		reset-names = "mipi-reset", "mipi_csi-reset", "mipi_phy_s-reset";
		resets = <&nexell_reset RESET_ID_MIPI>, <&nexell_reset RESET_ID_MIPI_CSI>, <&nexell_reset RESET_ID_PHY_S>;
		soc,tieoff = <NX_TIEOFF_MIPI0_NX_DPSRAM_1R1W_EMAA 3>;
		data_lane = <2>;
		swap_clocklane = <0>;
		swap_datalane = <0>;
		pllval = <750>;
		status = "disabled";
	};
```
