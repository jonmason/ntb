## Documentation/devicetree/bindings/rtc/ti,bq32k.txt
```
* TI BQ32000                I2C Serial Real-Time Clock

Required properties:
- compatible: Should contain "ti,bq32000".
- reg: I2C address for chip

Optional properties:
- trickle-resistor-ohms : Selected resistor for trickle charger
       Values usable are 1120 and 20180
       Should be given if trickle charger should be enabled
- trickle-diode-disable : Do not use internal trickle charger diode
       Should be given if internal trickle charger diode should be disabled
- init_time,{value} : default time value for first booting
	init_time properties used to set default time when booting first
	refer example, and it means "04/29/2016 (Fri)"
	-- init_time,year : Year
		: If realworld year over 2000, add 100. and add 2 digits.
	-- init_time,mon : Month
		: value = Realworld month - 1
	-- init_time,mday : Day
		: value = Realworld day
	-- init_time,wday : Day of the week,
		: Monday = 1, Tuesday = 2, Wednesday = 3.....

Example:
       bq32000: rtc@68 {
               compatible = "ti,bq32000";
               trickle-resistor-ohms = <1120>;
               reg = <0x68>;
	       init_time,year = <116>;
	       init_time,mon = <3>;
	       init_time,mday = <29>;
	       init_time,wday = <5>;
       };
```

## Documentation/devicetree/bindings/serial/nexell_uart.txt
```
* Nexell's UART Controller

The Nexell's UART controller is used for interfacing SoC with serial
communicaion devices.

The Nexell's UART controller is used same to Samsung Uart contoller.

Required properties:
- compatible: should be one of following:
  - "nexell,s5p6818-uart" -  s5p6818 SoC,

- reg: base physical address of the controller and length of memory mapped
  region.

- interrupts: a single interrupt signal to SoC interrupt controller,
  according to interrupt bindings documentation [1].

- clock-names: input names of clocks used by the controller:
  - "uart" - controller bus clock,
  - "clk_uart_baudN" - Nth baud base clock input (N = 0, 1, ...),
    according to SoC User's Manual (only N = 0 is allowedfor SoCs without
    internal baud clock mux).
- clocks: phandles and specifiers for all clocks specified in "clock-names"
  property, in the same order, according to clock bindings documentation [2].

- resets : phandle to the parent reset controller.
 - "nxp_reset" - reset-cotroller,
 - "RESET_ID_UARTN" - Nth Reset control id (N = 0, 1, ...)
- reset-names : input names of resets used by the controller

[1] Documentation/devicetree/bindings/interrupt-controller/interrupts.txt
[2] Documentation/devicetree/bindings/clock/clock-bindings.txts

Optional properties:
- samsung,uart-fifosize: The fifo size supported by the UART channel

- soc,tieoff : phandle to the tieoff control.

Note: Each Nexell UART should have an alias correctly numbered in the
"aliases" node, according to serialN format, where N is the port number
(non-negative decimal integer) as specified by User's Manual of respective
SoC.

Example:
	aliases {
		serail0 = &serial0;
		serail1 = &serial1;
		serail2 = &serial2;
		serail3 = &serial3;
		serail4 = &serial4;
		serail5 = &serial5;
	};

Example:
	serial0:serial@c00a1000 {
	        compatible = "nexell,s5p6818-uart";
	        reg = <PHYS_BASE_UART0 0x1000>;
	        interrupts = <0 IRQ_UART0  0>;
	        clock-names = "uart0";
	        clocks = <&uart0>;
	        resets  = <&nxp_reset RESET_ID_UART0>;
	        reset-names = "uart-reset";
	        soc,tieoff = < NX_TIEOFF_UART0_USESMC 0>,
	                     < NX_TIEOFF_UART0_SMCTXENB 0>,
	                     < NX_TIEOFF_UART0_SMCRXENB 0>;
	        pinctrl-names = "default";
	        pinctrl-0 = <&serial0_pin>;
	};
```

## Documentation/devicetree/bindings/sound/es8316.txt
```
Everest ES8316 audio CODEC

This device supports both I2C and SPI.

Required properties:

  - compatible : "everest,es8328"
  - reg : the I2C address of the device for I2C, the chip select number for SPI

Example:

es8316@11 {
	compatible = "everest,es8316";
	reg = <0x11>;
};
```

## Documentation/devicetree/bindings/sound/nexell,alc5623.txt
```
Nexell audio complex with ALC5623 codec

Required properties:
- compatible     : "nexell,nexell-alc5623"
- ch             : i2s channel of the ALC5623 audio codec
- sample_rate    : sample rate of the ALC5623 audio codec
- format         : audio format of the ALC5623 audio codec
- i2s-controller : The i2s controller phandle of the ALC5623 audio codec
- audio-codec    : The phandle of the ALC5623 audio codec

Optional Properties:
- hpin-support   : support GPIO for headphone jack
- hpin-gpio      : GPIO number for headphone jack
- hpin-level     : GPIO detect level for headphone jack
- amp-gpio       : GPIO number for speaker amps

Example:

sound {
	compatible = "nexell,nexell-alc5623";
	ch = <0>;
	sample-rate = <48000>;
	format = "S16";
	i2s-controller = <&i2s_0>;
	audio-codec = <&alc5623>;
	hpin-support = <1>;
	hpin-gpio = <&gpio_b 27 0>;
	hpin-level = <1>;
	amp-gpio = <&gpio_d 19 0>;
};
```

## Documentation/devicetree/bindings/sound/nexell,es8316.txt
```
Nexell audio complex with ES8316 codec

Required properties:
- compatible     : "nexell,nexell-es8316"
- ch             : i2s channel of the ES8316 audio codec
- sample_rate    : sample rate of the ES8316 audio codec
- format         : audio format of the ES8316 audio codec
- i2s-controller : The i2s controller phandle of the ES8316 audio codec
- audio-codec    : The phandle of the ES8316 audio codec

Optional Properties:
- hpin-support   : support GPIO for headphone jack
- hpin-gpio      : GPIO number for headphone jack
- hpin-level     : GPIO detect level for headphone jack
- amp-gpio       : GPIO number for speaker amps

Example:

sound {
	compatible = "nexell,nexell-es8316";
	ch = <0>;
	sample-rate = <48000>;
	format = "S16";
	i2s-controller = <&i2s_0>;
	audio-codec = <&es8316>;
	hpin-support = <1>;
	hpin-gpio = <&gpio_b 27 0>;
	hpin-level = <1>;
	amp-gpio = <&gpio_d 19 0>;
};
```

## Documentation/devicetree/bindings/sound/nexell,nexell-spdif-tx.txt
```
Nexell Sony/Philips Digital Interface Format (S/PDIF) Controller

The Nexell S/PDIF audio block is a stereo transceiver that allows the
processor to receive and transmit digital audio via an coaxial cable or
a fibre cable.

Required properties:

- compatible: Compatible list, must contain "nexell,nexell-spdif-tx".
- reg: Offset and length of the register set for the device.
- interrupts: Contains the spdif interrupt.
- dmas: Generic dma devicetree binding as described in
	Documentation/devicetree/bindings/dma/dma.txt.
- dma-names: Two dmas have to be defined, "tx" and "rx".
- clocks: Contains an entry for each entry in clock-names.
- clock-names: spdiftx uses some base clks from CMU and some are from audio
  subsystem internal clock controller. The clock names for i2s0 should be
  "spdif-tx" as shown in the example below.
- resets: phandle to the parent reset controller.
- "nexell_reset" - reset-controller,
  - "RESET_ID_SPDIFTX" - Nth Reset control id (N = 0, 1, ...)
- reset-names: input names of resets used by the controller

Optional Properties:

- pinctrl-0: Should specify pin control groups used for this controller.
- pinctrl-names: Should contain only one value - "default".
- pcm-bit : Select pcm bit. (16/24 bits)
- sample-rate : Select sample rate. (44100~96000hz)

Example:

spdiftx@c0059000 {
	compatible = "nexell,nexell-spdif-tx";
	reg = <PHYS_BASE_SPDIF_TX 0x1000>;
	interrupts = <0 IRQ_SPDIFTX 0>;
	dmas = <&pl08xdma1 6>;
	dma-names = "tx";
	resets = <&nexell_reset RESET_ID_SPDIFTX>;
	reset-names = "spdiftx-reset";
	clocks = <&spdiftx>;
	clock-names = "spdif-tx";
	pinctrl-names = "default";
	pinctrl-0 = <&spdiftx_pin>;
	pcm-bit = <16>;
	sample_rate = <48000>;
	status = "okay";
};
```

## Documentation/devicetree/bindings/sound/nexell,rt5640.txt
```
Nexell audio complex with RT5640 codec

Required properties:
- compatible     : "nexell,nexell-rt5640"
- ch             : i2s channel of the RT5640 audio codec
- sample_rate    : sample rate of the RT5640 audio codec
- format         : audio format of the RT5640 audio codec
- i2s-controller : The i2s controller phandle of the RT5640 audio codec
- audio-codec    : The phandle of the RT5640 audio codec

Optional Properties:
- hpin-support   : support GPIO for headphone jack
- hpin-gpio      : GPIO number for headphone jack
- hpin-level     : GPIO detect level for headphone jack
- amp-gpio       : GPIO number for speaker amps

Example:

sound {
	compatible = "nexell,nexell-rt5640";
	ch = <0>;
	sample-rate = <48000>;
	format = "S16";
	i2s-controller = <&i2s_0>;
	audio-codec = <&rt5640>;
	hpin-support = <1>;
	hpin-gpio = <&gpio_b 27 0>;
	hpin-level = <1>;
	amp-gpio = <&gpio_d 19 0>;
};
```

## Documentation/devicetree/bindings/sound/nexell,snd-null-card.txt
```
Nexell Null card

This device supports I2S Null card

Required Properties:

- compatible : should be one of the following.
   - nexell,snd-null-card: for I2S Null card.
- ch             : i2s channel of the Null audio codec
- sample_rate    : sample rate of the Null audio codec
- format         : audio format of the Null audio codec
- i2s-controller : The i2s controller phandle of the Null audio codec


Example:

snd_null_card_0:snd-_null_card@0 {
	compatible = "nexell,snd-null-card";
	ch = <0>;
	sample-rate = <48000>;
	format = "S16";
	i2s-controller = <&i2s_0>;
};
```

## Documentation/devicetree/bindings/sound/nexell,snd-null.txt
```
Nexell Null Codec

This device supports I2S Null codec

Required Properties:

- compatible : should be one of the following.
   - nexell,snd-null: for I2S Null codec.

Example:

snd-null {
	compatible = "nexell,snd-null";
};
```

## Documentation/devicetree/bindings/sound/nexell,spdif-transceiver.txt
```
Nexell Sony/Philips Digital Interface Format (S/PDIF) codec

Required properties:

- compatible     : Compatible list, must contain "nexell,spdif-transceiver"
- sample_rate    : sample rate of the spdif-transceiver audio codec
- format         : audio format of the spdif-transceiver audio codec

Example:

spdif-transceiver {
	compatible = "nexell,spdif-transceiver";
	sample_rate = <48000>;
	format = "S16";
};
```
