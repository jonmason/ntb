## Documentation/devicetree/bindings/misc/mediatek,e522xx.txt
```
usb charger driver for e522xx

Required properties:
- compatible : "mediatek,e522xx"
- en-gpio : Enable pin
- int-gpio = Interrupt pin
- reg : slave address

Example:
	e522xx: e522xx@13 {
		compatible = "mediatek,e522xx";
		en-gpio = <&gpio_d 0 GPIO_ACTIVE_HIGH>;
		int-gpio = <&gpio_c 31 GPIO_ACTIVE_LOW>;
		reg = <0x13>;
	};
```

## Documentation/devicetree/bindings/misc/mediatek,usb_charge.txt
```
usb charge driver

Required properties:
- compatible : "mediatek,usb_charge"

Example:
	usb_charge {
	        compatible= "mediatek,usb_charge";
	        status = "okay";
	};
```

## Documentation/devicetree/bindings/misc/nexell,scaler.txt
```
Scaler for Nexell s5pxx18 series SoC
-----------------------------------------------------
This binding defines Scaler to change image size.

Required properties:
- compatible:	should be set to "nexell,scaler"
- reg:		Location and size of Scaler registers
- interrupts:	external interrupt line number
- clock-names:	tuple listing input clock names.
- clocks:	list to input clocks.
- reset-names:	tuple listing Scaler reset clock names.
- resets:	list to reset clocks
- status:	set Enable or Disable operation of Scaler
		Enable : okay
		Disable : disable

Example for Scaler
- Enable for Scaler
	scaler:scaler@c0066000 {
		status ="okay";
	};

- Configuation for Scaler
	scaler:scaler@c0066000 {
			compatible = "nexell,scaler";
			reg = <PHYS_BASE_SCALER 0x1000>;
			interrupts = <0 IRQ_SCALER 0>;
			clock-names = "scaler-clock";
			clocks = <&scaler_clock>;
			reset-names = "scaler-reset";
			resets = <&nexell_reset RESET_ID_SCALER>;
			status = "disabled";
		};
```

## Documentation/devicetree/bindings/misc/samsung,artik_zb_power.txt
```
Zigbee power control for Samsung ARTIK Chip

This binding defines zigbee power control interface to control ARTIK's
zigbee(eq. EM3587).

Required properties:
- compatible : "samsung,artik_zb_power"
- vdd_zb-supply : 3v Regulator supply
- reset-gpio: nReset GPIO pin
- bootloader-gpio: nBootloader GPIO pin

Example:
	artik_zb_power {
		compatible = "samsung,artik_zb_power";
		vdd_zb-supply = <&VCC_DCDC2>;
		reset-gpio = <&gpio_c 8 0>;
		bootloader-gpio = <&gpio_c 28 0>;
	};
```

## Documentation/devicetree/bindings/misc/samsung,s3t9mf.txt
```
Secure Element Control driver for S3T9MF

This binding defines secure element control interface to control ARTIK's
secure element(eq. S3T9MF).

Required properties:
- compatible : "samsung,s3t9mf"
- reset-gpio: Reset GPIO pin
- pwms : PWM property to point to the PWM device (phandle)/port (id) and to
  specify the period time to be used: <&phandle id period_ns>;
- pwm-names : (optional) Name to be used by the PWM subsystem for the PWM device
  For the pwms and pwm-names property please refer to:
  Documentation/devicetree/bindings/pwm/pwm.txt

Example:
	artik_s3t9mf {
		compatible = "samsung,s3t9mf";
		reset-gpio = <&gpio_b 26 0>;
		pwms = <&pwm 1 121 0>
		pwm-names = "pwm_t9mf";
		status = "okay";
	};
```

## Documentation/devicetree/bindings/misc/ti,ub927928.txt
```
SERDES driver for ds90ub927928

Required properties:
- compatible : "ti,ub927928"
- reg : slave address

Example:
	ub927928@0c{
		compatible = "ti,ub927928";
		reg = <0x0c>;
	};
```

## Documentation/devicetree/bindings/mmc/nexell-dw-mshc.txt
```
* Nexell s5pxx18 specific extensions to the Synopsys Designware Mobile
  Storage Host Controller

The Synopsys designware mobile storage host controller is used to interface
a SoC with storage medium such as eMMC or SD/MMC cards. This file documents
differences between the core Synopsys dw mshc controller properties described
by synopsys-dw-mshc.txt and the properties used by the Nexell s5pxx18 specific
extensions to the Synopsys Designware Mobile Storage Host Controller.

Required Properties:

* compatible: should be
	- "nexell,s5p6818-dw-mshc" : for controllers with nexell s5pxx18.

* nexell,drive_dly : Output drive clock delay. range is 0 ~ 255.
* nexell,drive_shift : Output drive clock phase shift. range is 0 ~ 3
* nexell,sample_dly : Read sample clock delay. range is 0 ~ 255.
* nexell,sample_shift : Read sample clock phase shitf. range is 0 ~ 255.

* clock-names: input names of clocks used by the controller:
  - "sdhcN" - controller bus clock,
- clocks: phandles and specifiers for all clocks specified in "clock-names"
  property, in the same order, according to clock bindings documentation [2].

- resets : phandle to the parent reset controller.
 - "nxp_reset" - reset-cotroller,
 - "RESET_ID_SDMMCN" - Nth Reset control id (N = 0, 1, ...)
- reset-names : input names of resets used by the controller

[1] Documentation/devicetree/bindings/interrupt-controller/interrupts.txt
[2] Documentation/devicetree/bindings/clock/clock-bindings.txts

Nodes fot nexell clock timing value:
 - drive_dly, sample_dly : 1 step delay 1.2usec.
 - drive_shift, sample_shift :  1 step shuft 90 degree.

Optional properties:
- soc,tieoff : phandle to the tieoff control.
 use 8bit bus width ch2. Must set  1 NX_TIEOFF_MMC_8BIT Tieoff.

Example:
  The MSHC controller node can be split into two portions, SoC specific and
  board specific portions as listed below.

	dw_mmc_2:dw_mmc@c0069000 {
		compatible = "nexell,s5p6818-dw-mshc";
		interrupts = <0 IRQ_SDMMC2 0>;
		#address-cells = <1>;
		#size-cells = <0>;
		reg = <PHYS_BASE_SDMMC2 0x1000>;
		resets  = <&nexell_reset RESET_ID_SDMMC2>;
		reset-names = "dw_mmc-reset";
		clock-names = "sdhc2";
		clocks = <&sdhc2>;
		pinctrl-names = "default";
		pinctrl-0 = <&sdmmc2_cclk &sdmmc2_cmd &sdmmc2_bus4>;
		fifo-detph = <0x20>;
		status = "disable";
	};
	dw_mmc_2:dw_mmc@c0069000 {
		num-slots = <1>;
		bus-width = <8>;
		cap-mmc-highspeed;
		broken-cd;
		non-removable;
		clock-frequency = <200000000>;
		nexell,clk_dly = <0x02030000>;
		card-detect-delay = <200>;
		disable-wp;
		pinctrl-0 = <&sdmmc2_cclk &sdmmc2_cmd
		&sdmmc2_bus4 &sdmmc2_bus8>;
		status = "okay";
		nexell,drive_dly = <0x0>;
		nexell,drive_shift = <0x03>;
		nexell,sample_dly = <0x00>;
		nexell,sample_shift = <0x02>;
		soc,tieoff = <NX_TIEOFF_MMC_8BIT 1>;
	};
```

## Documentation/devicetree/bindings/net/nexell-dwmac.txt
```
Nexell SoC GMAC ethernet controller

This is a variant of the dwmac/stmmac driver an inherits all descriptions
present in Documentation/devicetree/bindings/net/stmmac.txt.

The device node has following properties.

Required properties:
 - compatible	: Can be "nexell,s5p6818-gmac".
 - pinctrl-names: Names corresponding to the numbered pinctrl states.
 - pinctrl-0: pin-control mode. can be <&rgmii_pins>
 - clocks: Should contain the GMAC main clock, and tx clock.
   The tx clock is using rx clock and the same frequency.
 - clock-names: Should contain the clock names "stmmaceth",
   and "nexell_gmac_tx"


Example:

	/* soc */
	gmac:gmac@c00c8000 {
		#clock-cells = <0>;
		cell-id = <CLK_ID_GMAC>;
		reg = <PHYS_BASE_CLK_10 0x1000>;
		clk-step   = <2>;
		clk-input  = <CLK_INPUT_GMAC>;
		clk-input1 = <CLK_INPUT_GMAC_IN1>;
		clock-output-names = "gmac";
		src-force = <4>;
	};

	gmac0:ethernet@c0060000 {
		compatible = "nexell,s5p6818-gmac";
		clocks = <&pclk>, <&gmac>;
		clock-names = "stmmaceth", "nexell_gmac_tx";
		resets = <&nexell_reset RESET_ID_DWC_GMAC>;
		reset-names = "stmmaceth";
		reg = <PHYS_BASE_GMAC 0x2000>;
		interrupt-parent = <&gic>;
		interrupts = <0 IRQ_GMAC 0>;
		interrupt-names = "macirq";
		mac-address = [000000000000];
		phy-mode = "rgmii";
		status = "disable";
	};


	/* board */
	gmac0:ethernet@c0060000 {
		pinctrl-names = "default";
		pinctrl-0 = <&rgmii_pins>;

		status = "okay";
		#address-cells = <0x1>;
		#size-cells = <0x0>;

		snps,phy-addr = <3>;
		snps,reset-gpio = <&gpio_a 10 0>;
		snps,reset-active-low;
		snps,reset-delays-us = <0 10000 10000>;

		phy-handle = <&ethernet_phy>;

		ethernet_phy:ethernet-phy@3 {
			compatible = "ethernet-phy-ieee802.3-c45";
			reg = <3>;
			device_type = "ethernet-phy";
		};
	};
```

## Documentation/devicetree/bindings/panel/dongguan,gst7d0038.txt
```
Dong guan GT Display GST7D0038 7.0" TFT LCD panel

Required properties:
- compatible: should be "dongguan,gst7d0038"

This binding is compatible with the simple-panel binding, which is specified
in simple-panel.txt in this directory.
```

## Documentation/devicetree/bindings/pinctrl/nexell,s5p6818-pinctrl.txt
```
Binding for Nexell s5p6818 pin cotroller
========================================

Nexell's ARM bases SoC's integrates a GPIO and Pin mux/config hardware
controller. It controls the input/output settings on the available pads/pins
and also provides ability to multiplex and configure the output of various
on-chip controllers onto these pads.

Please refer to pinctrl-bindings.txt in this directory for details of the
common pinctrl bindings used by client devices, including the meaning of the
phrase "pin configuration node".


Required properties:
  - compatible: may be "nexell,s5pxx18-pinctrl", "nexell,s5p6818-pinctrl"
  - reg: should be register base and length as documented in the datasheet
  - interrupts: interrupt specifier for the controller over gpio and alive pins

Example:
pinctrl_0: pinctrl@c0010000 {
	compatible = "nexell,s5pxx18-pinctrl";
	#address-cells = <1>;
	#size-cells = <1>;
	reg = <PHYS_BASE_GPIOA 0x1000
	       PHYS_BASE_GPIOB 0x1000
	       PHYS_BASE_GPIOC 0x1000
	       PHYS_BASE_GPIOD 0x1000
	       PHYS_BASE_GPIOE 0x1000
	       PHYS_BASE_ALIVE 0x800>;
	interrupts = <0 IRQ_GPIOA 0>,
		     <0 IRQ_GPIOB 0>,
		     <0 IRQ_GPIOC 0>,
		     <0 IRQ_GPIOD 0>,
		     <0 IRQ_GPIOE 0>,
		     <0 IRQ_ALIVE 0>;
};

  Note: Setting up the order must always match.


Nexell's pin configuration nodes act as a container for an arbitrary number of
subnodes. Each of these subnodes represents some desired configuration for a
pin, a group, or a list of pins or groups. This configuration can include the
mux function to select on those pin(s)/group(s), and various pin configuration
parameters.

  Child nodes must be set at least one of the following settings:
  - nexell,pins = Select pins for using this function.
  - nexell,pin-function = Select the function for use in a selected pin.
  - nexell,pin-pull = Pull up/down configuration.
  - nexell,pin-strength = Drive strength configuration.

  Valid values for nexell,pins are:
     "gpioX-N" : X in {A,B,C,D,E}, N in {0-31}
  Valid values for nexell,pin-function are:
     "N"       : N in {0-3}.
                 This setting means that the value is different for each pin.
                 Please refer to datasheet.
  Valid values for nexell,pin-pull are:
     "N"       : 0 - Down, 1 - Up, 2 - Off
  Valid values for nexell,pin-strength are:
     "N"       : 0,1,2,3


Example:
  - pin settings
	gmac_txd: gmac-txd {
		nexell,pins = "gpioe-7", "gpioe-8", "gpioe-9", "gpioe-10";
		nexell,pin-function = <1>;
		nexell,pin-pull = <2>;
		nexell,pin-strength = <3>;
	};

	gmac_rxd: gmac-rxd {
		nexell,pins = "gpioe-14", "gpioe-15", "gpioe-16", "gpioe-17";
		nexell,pin-function = <1>;
		nexell,pin-pull = <2>;
		nexell,pin-strength = <3>;
	};

	gmac_txen: gmac-txen {
		nexell,pins = "gpioe-11";
		nexell,pin-function = <1>;
		nexell,pin-pull = <2>;
		nexell,pin-strength = <3>;
	};

  - used by client devices
	gmac0:ethernet@... {
		pinctrl-names = "default";
		pinctrl-0 = <&gmac_txd &gmac_rxd &gmac_txen &gmac_mdc
		             &gmac_mdio &gmac_rxclk &gmac_txclk>;
		...
	};
```

## Documentation/devicetree/bindings/power/bq2429x.txt
```
Binding for TI bq2429x Charger

Required properties:
- compatible: Should contain one of the following:
 * "ti,bq24296"
 * "ti,bq24297"
- reg: i2c address of the device.
- ti,chg_current: maximum charging current for DC/USB/ADP in mA.
- gpios: gpio pins for charger interrupt and dc detect.

Example from artik710-raptor:

bq24296_charger@6b {
	compatible = "ti,bq24296";
	reg = <0x6b>;
	ti,chg_current = <1000 1500 2000>;
	gpios = <&gpio_a 10 0>;
};
```

## Documentation/devicetree/bindings/power/cw2015.txt
```
Binding for Cellwise cw2015 battery

Required properties:
- compatible: Should contain one of the following:
 * "cw201x"
- reg: i2c address of the device.
- bat_config_info: configuration data with battery.
- is_dc_charge: flag which indicate supporting dc charge.
- is_usb_charge: flag which indicate supporting usb charge.

Example from artik710-raptor:

cw2015@62 {
	compatible = "cw201x";
	reg = <0x62>;
	bat_config_info = <0x15 0x4C 0x78 0x48 0x25
		0x16 0x45 0x60 0x67 0x5D
		0x56 0x4C 0x58 0x58 0x53
		0x57 0x59 0x5C 0x5E 0x65
		0x57 0x6C 0x78 0x75 0x85
		0x91 0x07 0xAE 0x74 0xA4
		0x96 0xA3 0xC1 0xC2 0xD2
		0xBF 0x40 0x1F 0x98 0x19
		0x05 0x38 0x48 0x79 0x8D
		0x92 0x92 0x23 0x73 0x80
		0x94 0xB0 0x37 0xC1 0x91
		0xCB 0x2F 0x7D 0x72 0xA5
		0xB5 0xC1 0x15 0x09>;
	is_dc_charge = <1>;
	is_usb_charge = <0>;
};
																				};
```

## Documentation/devicetree/bindings/reset/nexell,reset-nxp5540.txt
```
Nexell NXP5540 Reset Controller
======================================

Please also refer to reset.txt in this directory for common reset
controller binding usage.

The reset controller registers are part of the system-ctl block on nxp5540 SoC.

Required properties:
- compatible: should be "nexell,nxp5540-reset"
- reg: should be register base and length as documented in the datasheet
- #reset-cells: 2, see below

Example:
nxp5540_reset:reset {
	#reset-cells = <2>;
	compatible = "nexell,nxp5540-reset";
	reg = <PHYS_BASE_SYS_RSTCON 0x800
	       PHYS_BASE_TBUS_RSTCON 0x800
	       PHYS_BASE_LBUS_RSTCON 0x800
	       PHYS_BASE_BBUS_RSTCON 0x800
	       PHYS_BASE_CODA_RSTCON 0x800
	       PHYS_BASE_DISP_RSTCON 0x800
	       PHYS_BASE_USB_RSTCON 0x800
	       PHYS_BASE_HDMI_RSTCON 0x800
	       PHYS_BASE_WAVE_RSTCON 0x800
	       PHYS_BASE_DREX_RSTCON 0x800
	       PHYS_BASE_WAVE420_RSTCON 0x800
	       PHYS_BASE_CPU_RSTCON 0x800
	       PHYS_BASE_PERICLK_RSTCON 0x800>;
	status = "okay";
};


Specifying reset lines connected to IP modules
==============================================
example:

	serial0:serial@..... {
		...
		resets  = <&nxp5540_reset RESET_BANK_BBUS RESET_ID_UART_0_CORE>;
		reset-names = "uart-reset";
                ...
        };

The index could be found in <dt-bindings/reset/nexell,nxp5540-reset.h>.
```

## Documentation/devicetree/bindings/reset/nexell,reset.txt
```
Nexell System Reset Controller
======================================

Please also refer to reset.txt in this directory for common reset
controller binding usage.

The reset controller registers are part of the system-ctl block on s5pxx18 SoC.

Required properties:
- compatible: may be "nexell,s5pxx18-reset"
- reg: should be register base and length as documented in the datasheet
- #reset-cells: 1, see below

Example:
nexell_reset:reset@c0012000 {
	#reset-cells = <1>;
	compatible = "nexell,s5pxx18-reset";
	reg = <0xC0012000 0x3>;
};

Specifying reset lines connected to IP modules
==============================================
example:

	serial0:serial@..... {
		...
		resets  = <&nexell_reset RESET_ID_UART0>;
		reset-names = "uart-reset";
                ...
        };

The index could be found in <dt-bindings/reset/nexell,{CHIP NAME}-reset.h>.
```

## Documentation/devicetree/bindings/rtc/rtc-nx.txt
```
Nexell Real Time Clock

Required properties:
- compatible:
  - "nexell,nx-rtc" - for RTC IP used similar to that on Nexell SoC family.
- reg: Address range of rtc register set
- interrupts: rtc timer, alarm interrupts in order

Example:

rtc@c0010c00 {
	compatible = "nexell,nx-rtc";
	reg = <PHYS_BASE_RTC 0x100>, <0xc0010200 0x100>;
	interrupts = <0 IRQ_RTC 0>;
	status = "okay";
};
```
